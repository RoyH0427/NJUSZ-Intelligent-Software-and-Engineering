/******************************************************************************
* ASAP2 file: thothfcu100.a2l
* Code generation for model "thothfcu100".
* Model version : 1.1077
* Simulink Coder version : 8.11 (R2016b) 25-Aug-2016
* C source code generated on : Mon Oct 16 14:14:25 2023
* Target selection: power_ecu_57a.tlc
* Embedded hardware selection: Freescale->MPC55xx
* Code generation objectives: Unspecified
* Validation result: Not run
* PowerECU : PowerECU-57AP
* PowerECU MBDToolbox Version : V3.24
******************************************************************************/ ASAP2_VERSION 1 31
/* Version 1.31 */
/begin PROJECT thothfcu100 "Project Comment Goes Here"
/begin HEADER "Header Comments go here" /end HEADER
/begin MODULE thothfcu100 "Module Comment Goes Here"
/begin IF_DATA ASAP1B_CCP
 /begin SOURCE "DAQ1_5ms" 0 0 DISPLAY_IDENTIFIER "DAQ1"
  /begin QP_BLOB 0 LENGTH 5 CAN_ID_FIXED 0x2A5 RASTER 0 REDUCTION_ALLOWED FIRST_PID 0 /end QP_BLOB
 /end SOURCE
 /begin SOURCE "DAQ2_10ms" 0 0 DISPLAY_IDENTIFIER "DAQ2"
  /begin QP_BLOB 1 LENGTH 10 CAN_ID_FIXED 0x2A5 RASTER 1 REDUCTION_ALLOWED FIRST_PID 30 /end QP_BLOB
 /end SOURCE
 /begin SOURCE "DAQ3_50ms" 0 0 DISPLAY_IDENTIFIER "DAQ3"
  /begin QP_BLOB 2 LENGTH 20 CAN_ID_FIXED 0x2A5 RASTER 2 REDUCTION_ALLOWED FIRST_PID 60 /end QP_BLOB
 /end SOURCE
 /begin SOURCE "DA4_100ms" 0 0 DISPLAY_IDENTIFIER "DAQ4"
  /begin QP_BLOB 3 LENGTH 30 CAN_ID_FIXED 0x2A5 RASTER 3 REDUCTION_ALLOWED FIRST_PID 90 /end QP_BLOB
 /end SOURCE
 /begin SOURCE "DA5_200ms" 0 0 DISPLAY_IDENTIFIER "DAQ5"
  /begin QP_BLOB 4 LENGTH 30 CAN_ID_FIXED 0x2A5 RASTER 4 REDUCTION_ALLOWED FIRST_PID 120 /end QP_BLOB
 /end SOURCE
 /begin RASTER "DAQ1_5ms" "DAQ1_5ms" 0 3 5 /end RASTER
 /begin RASTER "DAQ2_10ms" "DAQ2_10ms" 1 3 10 /end RASTER
 /begin RASTER "DAQ3_50ms" "DAQ3_50ms" 2 3 50 /end RASTER
 /begin RASTER "DAQ4_100ms" "DAQ4_100ms" 3 3 100 /end RASTER
 /begin RASTER "DAQ5_200ms" "DAQ5_200ms" 4 3 200 /end RASTER
 /begin SEED_KEY /* seed&key dll for CAL */ "" /* seed&key dll for DAQ */ "" /* seed&key dll for PGM */ "" /end SEED_KEY
 /begin TP_BLOB 0x201 /* CCP version */ 0x204 /* Blob version */ 0x2A4 /* CAN msg ID - send */ 0x2A5 /* CAN msg ID - recv */ 0xFE59 /* Station address */ 1 /* byte order */ BAUDRATE 500000 SAMPLE_RATE 1 SAMPLE_POINT 70 BTL_CYCLES 10 SJW 2 SYNC_EDGE SINGLE DAQ_MODE BURST CONSISTENCY ODT ADDRESS_EXTENSION DAQ
  /begin CHECKSUM_PARAM /* algorithm */ 0x0002 /* limit */ 0xFFFFFFFF CHECKSUM_CALCULATION ACTIVE_PAGE /end CHECKSUM_PARAM
  /begin DEFINED_PAGES 1 /* Memory page num */ "EE_Ovr_Cal Page" /* Page Name */ 0x00 /* address ext. */ 0x40050000 /* base address */ 0x00010000 /* page length */ RAM /* memory page in RAM */ RAM_INIT_BY_ECU /* memory page is initialised by ECU start-up */ /end DEFINED_PAGES
  OPTIONAL_CMD 0x5 /* TEST */ OPTIONAL_CMD 0x8 /* START_STOP_ALL */ OPTIONAL_CMD 0x9 /* GET_ACTIVE_CAL_PAGE */ /end TP_BLOB
/end IF_DATA
/begin MOD_PAR "MOD PAR Comment Goes Here"
 /begin MEMORY_SEGMENT /* Element name */ SRAM /* Long name */ "Internal RAM" /* Program type */ VARIABLES /* Memory type */ RAM /* Attribute */ INTERN /* Address */ 0x40000000 /* Size */ 0x00050000 /* Offset */ -1 -1 -1 -1 -1 /* IF data */ /end MEMORY_SEGMENT
 /begin MEMORY_SEGMENT /* Element name */ CALIBRATION /* Long name */ "Cal Data" /* Program type */ DATA /* Memory type */ FLASH /* Attribute */ INTERN /* Address */ 0x40050000 /* Size */ 0x00010000 /* Offset */ -1 -1 -1 -1 -1 /* IF data */ /end MEMORY_SEGMENT
/end MOD_PAR
/begin MOD_COMMON "Mod Common Comment Here" BYTE_ORDER MSB_FIRST ALIGNMENT_BYTE 1 ALIGNMENT_WORD 1 ALIGNMENT_LONG 1 ALIGNMENT_INT64 1 ALIGNMENT_FLOAT32_IEEE 1 ALIGNMENT_FLOAT64_IEEE 1 /end MOD_COMMON
/begin RECORD_LAYOUT Scalar_BOOLEAN FNC_VALUES 1 UBYTE COLUMN_DIR DIRECT /end RECORD_LAYOUT
/begin RECORD_LAYOUT Scalar_UBYTE FNC_VALUES 1 UBYTE COLUMN_DIR DIRECT /end RECORD_LAYOUT
/begin RECORD_LAYOUT Scalar_BYTE FNC_VALUES 1 SBYTE COLUMN_DIR DIRECT /end RECORD_LAYOUT
/begin RECORD_LAYOUT Scalar_UWORD FNC_VALUES 1 UWORD COLUMN_DIR DIRECT /end RECORD_LAYOUT
/begin RECORD_LAYOUT Scalar_SWORD FNC_VALUES 1 SWORD COLUMN_DIR DIRECT /end RECORD_LAYOUT
/begin RECORD_LAYOUT Scalar_ULONG FNC_VALUES 1 ULONG COLUMN_DIR DIRECT /end RECORD_LAYOUT
/begin RECORD_LAYOUT Scalar_LONG FNC_VALUES 1 SLONG COLUMN_DIR DIRECT /end RECORD_LAYOUT
/begin RECORD_LAYOUT Scalar_FLOAT32_IEEE FNC_VALUES 1 FLOAT32_IEEE COLUMN_DIR DIRECT /end RECORD_LAYOUT
/begin RECORD_LAYOUT Scalar_FLOAT64_IEEE FNC_VALUES 1 FLOAT64_IEEE COLUMN_DIR DIRECT /end RECORD_LAYOUT
/begin RECORD_LAYOUT Lookup1D_BOOLEAN FNC_VALUES 1 UBYTE COLUMN_DIR DIRECT /end RECORD_LAYOUT
/begin RECORD_LAYOUT Lookup1D_X_BOOLEAN AXIS_PTS_X 1 UBYTE INDEX_INCR DIRECT /end RECORD_LAYOUT
/begin RECORD_LAYOUT Lookup1D_BYTE FNC_VALUES 1 SBYTE COLUMN_DIR DIRECT /end RECORD_LAYOUT
/begin RECORD_LAYOUT Lookup1D_X_BYTE AXIS_PTS_X 1 SBYTE INDEX_INCR DIRECT /end RECORD_LAYOUT
/begin RECORD_LAYOUT Lookup1D_UBYTE FNC_VALUES 1 UBYTE COLUMN_DIR DIRECT /end RECORD_LAYOUT
/begin RECORD_LAYOUT Lookup1D_X_UBYTE AXIS_PTS_X 1 UBYTE INDEX_INCR DIRECT /end RECORD_LAYOUT
/begin RECORD_LAYOUT Lookup1D_UWORD FNC_VALUES 1 UWORD COLUMN_DIR DIRECT /end RECORD_LAYOUT
/begin RECORD_LAYOUT Lookup1D_X_UWORD AXIS_PTS_X 1 UWORD INDEX_INCR DIRECT /end RECORD_LAYOUT
/begin RECORD_LAYOUT Lookup1D_WORD FNC_VALUES 1 SWORD COLUMN_DIR DIRECT /end RECORD_LAYOUT
/begin RECORD_LAYOUT Lookup1D_X_WORD AXIS_PTS_X 1 SWORD INDEX_INCR DIRECT /end RECORD_LAYOUT
/begin RECORD_LAYOUT Lookup1D_ULONG FNC_VALUES 1 ULONG COLUMN_DIR DIRECT /end RECORD_LAYOUT
/begin RECORD_LAYOUT Lookup1D_X_ULONG AXIS_PTS_X 1 ULONG INDEX_INCR DIRECT /end RECORD_LAYOUT
/begin RECORD_LAYOUT Lookup1D_SLONG FNC_VALUES 1 SLONG COLUMN_DIR DIRECT /end RECORD_LAYOUT
/begin RECORD_LAYOUT Lookup1D_X_LONG AXIS_PTS_X 1 SLONG INDEX_INCR DIRECT /end RECORD_LAYOUT
/begin RECORD_LAYOUT Lookup1D_FLOAT32_IEEE FNC_VALUES 1 FLOAT32_IEEE COLUMN_DIR DIRECT /end RECORD_LAYOUT
/begin RECORD_LAYOUT Lookup1D_X_FLOAT32_IEEE AXIS_PTS_X 1 FLOAT32_IEEE INDEX_INCR DIRECT /end RECORD_LAYOUT
/begin RECORD_LAYOUT Lookup1D_FLOAT64_IEEE FNC_VALUES 1 FLOAT64_IEEE COLUMN_DIR DIRECT /end RECORD_LAYOUT
/begin RECORD_LAYOUT Lookup1D_X_FLOAT64_IEEE AXIS_PTS_X 1 FLOAT64_IEEE INDEX_INCR DIRECT /end RECORD_LAYOUT
/begin RECORD_LAYOUT Lookup2D_BOOLEAN FNC_VALUES 1 UBYTE COLUMN_DIR DIRECT /end RECORD_LAYOUT
/begin RECORD_LAYOUT Lookup2D_X_BOOLEAN AXIS_PTS_X 1 UBYTE INDEX_INCR DIRECT /end RECORD_LAYOUT
/begin RECORD_LAYOUT Lookup2D_UBYTE FNC_VALUES 1 UBYTE COLUMN_DIR DIRECT /end RECORD_LAYOUT
/begin RECORD_LAYOUT Lookup2D_X_UBYTE AXIS_PTS_X 1 UBYTE INDEX_INCR DIRECT /end RECORD_LAYOUT
/begin RECORD_LAYOUT Lookup2D_BYTE FNC_VALUES 1 SBYTE COLUMN_DIR DIRECT /end RECORD_LAYOUT
/begin RECORD_LAYOUT Lookup2D_X_BYTE AXIS_PTS_X 1 SBYTE INDEX_INCR DIRECT /end RECORD_LAYOUT
/begin RECORD_LAYOUT Lookup2D_UWORD FNC_VALUES 1 UWORD COLUMN_DIR DIRECT /end RECORD_LAYOUT
/begin RECORD_LAYOUT Lookup2D_X_UWORD AXIS_PTS_X 1 UWORD INDEX_INCR DIRECT /end RECORD_LAYOUT
/begin RECORD_LAYOUT Lookup2D_WORD FNC_VALUES 1 SWORD COLUMN_DIR DIRECT /end RECORD_LAYOUT
/begin RECORD_LAYOUT Lookup2D_X_WORD AXIS_PTS_X 1 SWORD INDEX_INCR DIRECT /end RECORD_LAYOUT
/begin RECORD_LAYOUT Lookup2D_ULONG FNC_VALUES 1 ULONG COLUMN_DIR DIRECT /end RECORD_LAYOUT
/begin RECORD_LAYOUT Lookup2D_X_ULONG AXIS_PTS_X 1 ULONG INDEX_INCR DIRECT /end RECORD_LAYOUT
/begin RECORD_LAYOUT Lookup2D_LONG FNC_VALUES 1 SLONG COLUMN_DIR DIRECT /end RECORD_LAYOUT
/begin RECORD_LAYOUT Lookup2D_X_LONG AXIS_PTS_X 1 SLONG INDEX_INCR DIRECT /end RECORD_LAYOUT
/begin RECORD_LAYOUT Lookup2D_FLOAT32_IEEE FNC_VALUES 1 FLOAT32_IEEE COLUMN_DIR DIRECT /end RECORD_LAYOUT
/begin RECORD_LAYOUT Lookup2D_X_FLOAT32_IEEE AXIS_PTS_X 1 FLOAT32_IEEE INDEX_INCR DIRECT /end RECORD_LAYOUT
/begin RECORD_LAYOUT Lookup2D_FLOAT64_IEEE FNC_VALUES 1 FLOAT64_IEEE COLUMN_DIR DIRECT /end RECORD_LAYOUT
/begin RECORD_LAYOUT Lookup2D_X_FLOAT64_IEEE AXIS_PTS_X 1 FLOAT64_IEEE INDEX_INCR DIRECT /end RECORD_LAYOUT
/begin CHARACTERISTIC AI_LSD_Table_Data "LSD PWM" /* Characteristic Type */ CURVE 0x400540e0 Lookup1D_SLONG /* Maxdiff */ 0 thothfcu100_CM_int32 0.0 4096.0
 /begin AXIS_DESCR /* Description of X-Axis Points */ /* Axis Type */ COM_AXIS /* Reference to Input */ NO_INPUT_QUANTITY thothfcu100_CM_int32 /* Number of Axis Pts */ 4 0.0 5000.0 AXIS_PTS_REF AI_LSD_Table_Bp /end AXIS_DESCR
/end CHARACTERISTIC
/begin AXIS_PTS AI_LSD_Table_Bp "AI(ADC)" 0x400540f0 /* Input Quantity */ NO_INPUT_QUANTITY Lookup1D_X_LONG 0 thothfcu100_CM_int32 /* Number of Axis Pts */ 4 0.0 5000.0 /end AXIS_PTS
/begin CHARACTERISTIC cov_hi "kp" VALUE 0x400540c8 Scalar_FLOAT32_IEEE 0 thothfcu100_CM_single -3.4E+38 3.4E+38 /end CHARACTERISTIC
/begin CHARACTERISTIC cov_kdhipc "kp" VALUE 0x400540c4 Scalar_FLOAT32_IEEE 0 thothfcu100_CM_single -3.4E+38 3.4E+38 /end CHARACTERISTIC
/begin CHARACTERISTIC cov_kdhipo "kp" VALUE 0x400540c0 Scalar_FLOAT32_IEEE 0 thothfcu100_CM_single -3.4E+38 3.4E+38 /end CHARACTERISTIC
/begin CHARACTERISTIC cov_kdin "kd" VALUE 0x400540bc Scalar_FLOAT32_IEEE 0 thothfcu100_CM_single -3.4E+38 3.4E+38 /end CHARACTERISTIC
/begin CHARACTERISTIC cov_kihipc "kp" VALUE 0x400540b8 Scalar_FLOAT32_IEEE 0 thothfcu100_CM_single -3.4E+38 3.4E+38 /end CHARACTERISTIC
/begin CHARACTERISTIC cov_kihipo "kp" VALUE 0x400540b4 Scalar_FLOAT32_IEEE 0 thothfcu100_CM_single -3.4E+38 3.4E+38 /end CHARACTERISTIC
/begin CHARACTERISTIC cov_kiin "ki" VALUE 0x400540b0 Scalar_FLOAT32_IEEE 0 thothfcu100_CM_single -3.4E+38 3.4E+38 /end CHARACTERISTIC
/begin CHARACTERISTIC cov_kphipc "kp" VALUE 0x400540ac Scalar_FLOAT32_IEEE 0 thothfcu100_CM_single -3.4E+38 3.4E+38 /end CHARACTERISTIC
/begin CHARACTERISTIC cov_kphipo "kp" VALUE 0x400540a8 Scalar_FLOAT32_IEEE 0 thothfcu100_CM_single -3.4E+38 3.4E+38 /end CHARACTERISTIC
/begin CHARACTERISTIC cov_kpin "kp" VALUE 0x400540a4 Scalar_FLOAT32_IEEE 0 thothfcu100_CM_single -3.4E+38 3.4E+38 /end CHARACTERISTIC
/begin CHARACTERISTIC cov_low "kp" VALUE 0x400540a0 Scalar_FLOAT32_IEEE 0 thothfcu100_CM_single -3.4E+38 3.4E+38 /end CHARACTERISTIC
/begin CHARACTERISTIC cvADETVP301 "" VALUE 0x40054088 Scalar_FLOAT32_IEEE 0 thothfcu100_CM_single -1.0 100.0 /end CHARACTERISTIC
/begin CHARACTERISTIC cvADETVP401 "" VALUE 0x40054084 Scalar_FLOAT32_IEEE 0 thothfcu100_CM_single -1.0 100.0 /end CHARACTERISTIC
/begin CHARACTERISTIC cvADETVP501 "" VALUE 0x40054080 Scalar_FLOAT32_IEEE 0 thothfcu100_CM_single -1.0 100.0 /end CHARACTERISTIC
/begin CHARACTERISTIC cvHPFCSHSpeed "" VALUE 0x40054060 Scalar_FLOAT32_IEEE 0 thothfcu100_CM_single -3.4E+38 3.4E+38 /end CHARACTERISTIC
/begin CHARACTERISTIC cvKeyFlow "kp" VALUE 0x4005404c Scalar_FLOAT32_IEEE 0 thothfcu100_CM_single -3.4E+38 3.4E+38 /end CHARACTERISTIC
/begin CHARACTERISTIC cvKeyPresure "kp" VALUE 0x40054048 Scalar_FLOAT32_IEEE 0 thothfcu100_CM_single -3.4E+38 3.4E+38 /end CHARACTERISTIC
/begin CHARACTERISTIC cvTargetFlow "kp" VALUE 0x4005401c Scalar_FLOAT32_IEEE 0 thothfcu100_CM_single -3.4E+38 3.4E+38 /end CHARACTERISTIC
/begin CHARACTERISTIC cvTargetHIPres "kp" VALUE 0x40054018 Scalar_FLOAT32_IEEE 0 thothfcu100_CM_single -3.4E+38 3.4E+38 /end CHARACTERISTIC
/begin CHARACTERISTIC cvTargetHIPresC "kp" VALUE 0x40054014 Scalar_FLOAT32_IEEE 0 thothfcu100_CM_single -3.4E+38 3.4E+38 /end CHARACTERISTIC
/begin CHARACTERISTIC cvTargetPresure "kp" VALUE 0x40054010 Scalar_FLOAT32_IEEE 0 thothfcu100_CM_single -3.4E+38 3.4E+38 /end CHARACTERISTIC
/begin CHARACTERISTIC cvThermValid "" VALUE 0x40054008 Scalar_FLOAT32_IEEE 0 thothfcu100_CM_single -3.4E+38 3.4E+38 /end CHARACTERISTIC
/begin CHARACTERISTIC cov_HiAd "kp" VALUE 0x400540d8 Scalar_LONG 0 thothfcu100_CM_int32 -2147483648 2147483647 /end CHARACTERISTIC
/begin CHARACTERISTIC cov_LoAd "kp" VALUE 0x400540d4 Scalar_LONG 0 thothfcu100_CM_int32 -2147483648 2147483647 /end CHARACTERISTIC
/begin CHARACTERISTIC cov_compens "kp" VALUE 0x400540cc Scalar_LONG 0 thothfcu100_CM_int32 -2147483648 2147483647 /end CHARACTERISTIC
/begin CHARACTERISTIC cvACSpeed "" VALUE 0x40054094 Scalar_LONG 0 thothfcu100_CM_int32 -2147483648 2147483647 /end CHARACTERISTIC
/begin CHARACTERISTIC cvDCK3 "DCK3����" VALUE 0x40054074 Scalar_LONG 0 thothfcu100_CM_int32 -1.0 1.0 /end CHARACTERISTIC
/begin CHARACTERISTIC cvDCK4 "DCK4����" VALUE 0x40054070 Scalar_LONG 0 thothfcu100_CM_int32 -1.0 1.0 /end CHARACTERISTIC
/begin CHARACTERISTIC cvHDrain "������ˮ��" VALUE 0x40054068 Scalar_LONG 0 thothfcu100_CM_int32 -1.0 1.0 /end CHARACTERISTIC
/begin CHARACTERISTIC cvHProport "��������������" VALUE 0x40054058 Scalar_LONG 0 thothfcu100_CM_int32 -1.0 4096.0 /end CHARACTERISTIC
/begin CHARACTERISTIC cvHRelease "����������" VALUE 0x40054054 Scalar_LONG 0 thothfcu100_CM_int32 -1.0 1.0 /end CHARACTERISTIC
/begin CHARACTERISTIC cvHStop "��ֹ��" VALUE 0x40054050 Scalar_LONG 0 thothfcu100_CM_int32 -1.0 1.0 /end CHARACTERISTIC
/begin CHARACTERISTIC cvMainFan "" VALUE 0x4005403c Scalar_LONG 0 thothfcu100_CM_int32 0.0 4096.0 /end CHARACTERISTIC
/begin CHARACTERISTIC cvPTCDisCharge "" VALUE 0x40054038 Scalar_LONG 0 thothfcu100_CM_int32 -1.0 3.0 /end CHARACTERISTIC
/begin CHARACTERISTIC cvPTCEmgOff "" VALUE 0x40054034 Scalar_LONG 0 thothfcu100_CM_int32 -1.0 1.0 /end CHARACTERISTIC
/begin CHARACTERISTIC cvPTCHeat "" VALUE 0x40054030 Scalar_LONG 0 thothfcu100_CM_int32 -1.0 100.0 /end CHARACTERISTIC
/begin CHARACTERISTIC cvPTCOn "" VALUE 0x4005402c Scalar_LONG 0 thothfcu100_CM_int32 -1.0 3.0 /end CHARACTERISTIC
/begin CHARACTERISTIC cvPTCReset "" VALUE 0x40054028 Scalar_LONG 0 thothfcu100_CM_int32 -1.0 3.0 /end CHARACTERISTIC
/begin CHARACTERISTIC cvPTCTran "" VALUE 0x40054024 Scalar_LONG 0 thothfcu100_CM_int32 -1.0 1.0 /end CHARACTERISTIC
/begin CHARACTERISTIC cvStartUp "" VALUE 0x40054020 Scalar_LONG 0 thothfcu100_CM_int32 -2147483648 2147483647 /end CHARACTERISTIC
/begin CHARACTERISTIC cvViceFan "��ɢ�ȷ���" VALUE 0x40054004 Scalar_LONG 0 thothfcu100_CM_int32 0.0 4096.0 /end CHARACTERISTIC
/begin CHARACTERISTIC cvVicePump "��ɢ��ˮ��" VALUE 0x40054000 Scalar_LONG 0 thothfcu100_CM_int32 0.0 4096.0 /end CHARACTERISTIC
/begin CHARACTERISTIC cvMPSpeed "" VALUE 0x40054042 Scalar_SWORD 0 thothfcu100_CM_int16 -1.0 5100.0 /end CHARACTERISTIC
/begin CHARACTERISTIC cov_releasec "kp" VALUE 0x4005409c Scalar_UWORD 0 thothfcu100_CM_uint16 0 65535 /end CHARACTERISTIC
/begin CHARACTERISTIC cov_releaseo "kp" VALUE 0x4005409a Scalar_UWORD 0 thothfcu100_CM_uint16 0 65535 /end CHARACTERISTIC
/begin CHARACTERISTIC cvDCHIin "" VALUE 0x40054078 Scalar_UWORD 0 thothfcu100_CM_uint16 0.0 65535.0 /end CHARACTERISTIC
/begin CHARACTERISTIC cov_aftercounts "kp" VALUE 0x400540d0 Scalar_BYTE 0 thothfcu100_CM_int8 -128 127 /end CHARACTERISTIC
/begin CHARACTERISTIC cov_precounts "kp" VALUE 0x4005409e Scalar_BYTE 0 thothfcu100_CM_int8 -128 127 /end CHARACTERISTIC
/begin CHARACTERISTIC cov_workCond "kp" VALUE 0x40054099 Scalar_BYTE 0 thothfcu100_CM_int8 -128 127 /end CHARACTERISTIC
/begin CHARACTERISTIC cvACTran "" VALUE 0x40054092 Scalar_BYTE 0 thothfcu100_CM_int8 -128 127 /end CHARACTERISTIC
/begin CHARACTERISTIC cvAD301Tran "" VALUE 0x40054091 Scalar_BYTE 0 thothfcu100_CM_int8 -1.0 1.0 /end CHARACTERISTIC
/begin CHARACTERISTIC cvAD401Tran "" VALUE 0x40054090 Scalar_BYTE 0 thothfcu100_CM_int8 -1.0 1.0 /end CHARACTERISTIC
/begin CHARACTERISTIC cvAD501Tran "" VALUE 0x4005408f Scalar_BYTE 0 thothfcu100_CM_int8 -1.0 1.0 /end CHARACTERISTIC
/begin CHARACTERISTIC cvADETVC301 "" VALUE 0x4005408e Scalar_BYTE 0 thothfcu100_CM_int8 -1.0 1.0 /end CHARACTERISTIC
/begin CHARACTERISTIC cvADETVC401 "" VALUE 0x4005408d Scalar_BYTE 0 thothfcu100_CM_int8 -1.0 1.0 /end CHARACTERISTIC
/begin CHARACTERISTIC cvADETVC501 "" VALUE 0x4005408c Scalar_BYTE 0 thothfcu100_CM_int8 -1.0 1.0 /end CHARACTERISTIC
/begin CHARACTERISTIC cvAcTest "" VALUE 0x4005407c Scalar_BYTE 0 thothfcu100_CM_int8 -128 127 /end CHARACTERISTIC
/begin CHARACTERISTIC cvDCTran "" VALUE 0x4005406c Scalar_BYTE 0 thothfcu100_CM_int8 -128 127 /end CHARACTERISTIC
/begin CHARACTERISTIC cvHPFCSHMode "" VALUE 0x40054064 Scalar_BYTE 0 thothfcu100_CM_int8 -128 127 /end CHARACTERISTIC
/begin CHARACTERISTIC cvHPTran "" VALUE 0x4005405c Scalar_BYTE 0 thothfcu100_CM_int8 -128 127 /end CHARACTERISTIC
/begin CHARACTERISTIC cvMPEn "" VALUE 0x40054044 Scalar_BYTE 0 thothfcu100_CM_int8 -1.0 3.0 /end CHARACTERISTIC
/begin CHARACTERISTIC cvMPTran "" VALUE 0x40054040 Scalar_BYTE 0 thothfcu100_CM_int8 -1.0 1.0 /end CHARACTERISTIC
/begin CHARACTERISTIC cvThermOper "" VALUE 0x4005400d Scalar_BYTE 0 thothfcu100_CM_int8 -128 127 /end CHARACTERISTIC
/begin CHARACTERISTIC cvThermTran "" VALUE 0x4005400c Scalar_BYTE 0 thothfcu100_CM_int8 -128 127 /end CHARACTERISTIC
/begin CHARACTERISTIC cvACEnable "" VALUE 0x40054098 Scalar_UBYTE 0 thothfcu100_CM_uint8 0 255 /end CHARACTERISTIC
/begin CHARACTERISTIC cvDCHCtrl "" VALUE 0x4005407b Scalar_UBYTE 0 thothfcu100_CM_uint8 0.0 255.0 /end CHARACTERISTIC
/begin CHARACTERISTIC cvDCHHidden "" VALUE 0x4005407a Scalar_UBYTE 0 thothfcu100_CM_uint8 0.0 255.0 /end CHARACTERISTIC
/begin CHARACTERISTIC Diagnosis_Detect_Enable "" VALUE 0x400540dc Scalar_BOOLEAN 0 thothfcu100_CM_boolean 0 1 /end CHARACTERISTIC
/begin CHARACTERISTIC Diagnosis_Detect_Rst "" VALUE 0x40050000 Scalar_BOOLEAN 0 thothfcu100_CM_boolean 0 1 /end CHARACTERISTIC
/begin MEASUREMENT sp7HTStacIn "���������¶�" FLOAT32_IEEE thothfcu100_CM_single 0 0 0.0 5000.0 ECU_ADDRESS 0x400018b4 /end MEASUREMENT
/begin MEASUREMENT sp8HTStacOut "���������¶�" FLOAT32_IEEE thothfcu100_CM_single 0 0 0.0 5000.0 ECU_ADDRESS 0x40001808 /end MEASUREMENT
/begin MEASUREMENT sp9HTPumpOut "������ѭ�����¶�" FLOAT32_IEEE thothfcu100_CM_single 0 0 0.0 5000.0 ECU_ADDRESS 0x40001800 /end MEASUREMENT
/begin MEASUREMENT sp10ATCoolOut "�������������¶�" FLOAT32_IEEE thothfcu100_CM_single 0 0 0.0 5000.0 ECU_ADDRESS 0x400018f0 /end MEASUREMENT
/begin MEASUREMENT sp11ATStacIn "���������¶�" FLOAT32_IEEE thothfcu100_CM_single 0 0 0.0 5000.0 ECU_ADDRESS 0x40001978 /end MEASUREMENT
/begin MEASUREMENT sp18ATStacOut "���������¶�" FLOAT32_IEEE thothfcu100_CM_single 0 0 0.0 5000.0 ECU_ADDRESS 0x40001968 /end MEASUREMENT
/begin MEASUREMENT sp30WTStacIn "��ȴˮ�����¶�" FLOAT32_IEEE thothfcu100_CM_single 0 0 0.0 5000.0 ECU_ADDRESS 0x40001958 /end MEASUREMENT
/begin MEASUREMENT sp31WTStacOut "��ȴˮ�����¶�" FLOAT32_IEEE thothfcu100_CM_single 0 0 0.0 5000.0 ECU_ADDRESS 0x4000192c /end MEASUREMENT
/begin MEASUREMENT sp0HPProp "��ѹ(��ƿ����ѹ��)" FLOAT32_IEEE thothfcu100_CM_single 0 0 0.0 5000.0 ECU_ADDRESS 0x40001a24 /end MEASUREMENT
/begin MEASUREMENT sp1HPStacIn "��������ѹ������ѹ��" FLOAT32_IEEE thothfcu100_CM_single 0 0 0.0 5000.0 ECU_ADDRESS 0x40001904 /end MEASUREMENT
/begin MEASUREMENT sp2HPStacOut "��������ѹ������ѹ����" FLOAT32_IEEE thothfcu100_CM_single_mPa 0 0 0.0 5000.0 ECU_ADDRESS 0x4000184c /end MEASUREMENT
/begin MEASUREMENT sp5WPStatcIn "��ȴ����ѹ������ѹ��" FLOAT32_IEEE thothfcu100_CM_single_mPa 0 0 0.0 5000.0 ECU_ADDRESS 0x40001928 /end MEASUREMENT
/begin MEASUREMENT sp6WPStacOut "��ȴ����ѹ������ѹ��" FLOAT32_IEEE thothfcu100_CM_single_mPa 0 0 0.0 5000.0 ECU_ADDRESS 0x40001a80 /end MEASUREMENT
/begin MEASUREMENT sp14APCoolOut "������������ѹ������ѹ��" FLOAT32_IEEE thothfcu100_CM_single_mPa 0 0 0.0 5000.0 ECU_ADDRESS 0x4000183c /end MEASUREMENT
/begin MEASUREMENT sp15APStacIn "��������ѹ������ѹ��" FLOAT32_IEEE thothfcu100_CM_single_mPa 0 0 0.0 5000.0 ECU_ADDRESS 0x40001a7c /end MEASUREMENT
/begin MEASUREMENT sp16APStacOut "��������ѹ������ѹ��" FLOAT32_IEEE thothfcu100_CM_single_mPa 0 0 0.0 5000.0 ECU_ADDRESS 0x40001890 /end MEASUREMENT
/begin MEASUREMENT sp1RawHPStacIn "��������ѹ������ѹ��" FLOAT32_IEEE thothfcu100_CM_single 0 0 0.0 5000.0 ECU_ADDRESS 0x4000199c /end MEASUREMENT
/begin MEASUREMENT spAirFlow "" FLOAT32_IEEE thothfcu100_CM_single 0 0 -3.4E+38 3.4E+38 ECU_ADDRESS 0x40001aa0 /end MEASUREMENT
/begin MEASUREMENT ThermSActualPostion "" FLOAT32_IEEE thothfcu100_CM_single 0 0 0.0 1.0 ECU_ADDRESS 0x40001880 /end MEASUREMENT
/begin MEASUREMENT ThermSTargetPostion "" FLOAT32_IEEE thothfcu100_CM_single 0 0 0.0 1.0 ECU_ADDRESS 0x400017e4 /end MEASUREMENT
/begin MEASUREMENT ThermSTemperature "" FLOAT32_IEEE thothfcu100_CM_single 0 0 0.0 1.0 ECU_ADDRESS 0x4000190c /end MEASUREMENT
/begin MEASUREMENT ETV511CurrentPostion "" FLOAT32_IEEE thothfcu100_CM_single 0 0 0.0 1.0 ECU_ADDRESS 0x40001810 /end MEASUREMENT
/begin MEASUREMENT ETV511TargetPosition "" FLOAT32_IEEE thothfcu100_CM_single 0 0 0.0 1.0 ECU_ADDRESS 0x400018fc /end MEASUREMENT
/begin MEASUREMENT ETV411CurrentPostion "" FLOAT32_IEEE thothfcu100_CM_single 0 0 0.0 1.0 ECU_ADDRESS 0x40001a84 /end MEASUREMENT
/begin MEASUREMENT ETV411TargetPosition "" FLOAT32_IEEE thothfcu100_CM_single 0 0 0.0 1.0 ECU_ADDRESS 0x40001828 /end MEASUREMENT
/begin MEASUREMENT ETV311CurrentPostion "" FLOAT32_IEEE thothfcu100_CM_single 0 0 0.0 1.0 ECU_ADDRESS 0x40001a40 /end MEASUREMENT
/begin MEASUREMENT ETV311TargetPosition "" FLOAT32_IEEE thothfcu100_CM_single 0 0 0.0 1.0 ECU_ADDRESS 0x40001a94 /end MEASUREMENT
/begin MEASUREMENT AirCompBusBarCurrent "" FLOAT32_IEEE thothfcu100_CM_single 0 0 0.0 125.0 ECU_ADDRESS 0x40001860 /end MEASUREMENT
/begin MEASUREMENT AirCompMotorCurrent "" FLOAT32_IEEE thothfcu100_CM_single 0 0 0.0 1.0 ECU_ADDRESS 0x400018bc /end MEASUREMENT
/begin MEASUREMENT HPumpCurrent "" FLOAT32_IEEE thothfcu100_CM_single 0 0 0.0 1.0 ECU_ADDRESS 0x400019d4 /end MEASUREMENT
/begin MEASUREMENT MainPumpCurrentIN "" FLOAT32_IEEE thothfcu100_CM_single 0 0 0.0 12.75 ECU_ADDRESS 0x40001a18 /end MEASUREMENT
/begin MEASUREMENT MainPumpHVoltageIN "" FLOAT32_IEEE thothfcu100_CM_single 0 0 0.0 1020.0 ECU_ADDRESS 0x40001868 /end MEASUREMENT
/begin MEASUREMENT MainPumpInnerTemperature "" FLOAT32_IEEE thothfcu100_CM_single 0 0 50.0 305.0 ECU_ADDRESS 0x40001820 /end MEASUREMENT
/begin MEASUREMENT HV_PTC_HV_DC_currFb "" FLOAT32_IEEE thothfcu100_CM_single 0 0 0.0 1.0 ECU_ADDRESS 0x400017e0 /end MEASUREMENT
/begin MEASUREMENT pbHiL "" FLOAT32_IEEE thothfcu100_CM_single 0 0 -3.4E+38 3.4E+38 ECU_ADDRESS 0x400019b4 /end MEASUREMENT
/begin MEASUREMENT pbPre401 "" FLOAT32_IEEE thothfcu100_CM_single 0 0 -3.4E+38 3.4E+38 ECU_ADDRESS 0x400019ac /end MEASUREMENT
/begin MEASUREMENT pbAdjust401 "" FLOAT32_IEEE thothfcu100_CM_single 0 0 -3.4E+38 3.4E+38 ECU_ADDRESS 0x40001a8c /end MEASUREMENT
/begin MEASUREMENT pbLowL "" FLOAT32_IEEE thothfcu100_CM_single 0 0 -3.4E+38 3.4E+38 ECU_ADDRESS 0x40001844 /end MEASUREMENT
/begin MEASUREMENT pbaesum "" FLOAT32_IEEE thothfcu100_CM_single 0 0 -3.4E+38 3.4E+38 ECU_ADDRESS 0x40001914 /end MEASUREMENT
/begin MEASUREMENT splsd0HProport "����������״̬" SLONG thothfcu100_CM_int32 0 0 -2147483648 2147483647 ECU_ADDRESS 0x40001aac /end MEASUREMENT
/begin MEASUREMENT splsd16DC3 "DC����K3״̬" SLONG thothfcu100_CM_int32 0 0 -2147483648 2147483647 ECU_ADDRESS 0x40001898 /end MEASUREMENT
/begin MEASUREMENT splsd17DC4 "DC����K4״̬" SLONG thothfcu100_CM_int32 0 0 -2147483648 2147483647 ECU_ADDRESS 0x40001970 /end MEASUREMENT
/begin MEASUREMENT splsd20HStop "������ֹ��״̬" SLONG thothfcu100_CM_int32 0 0 -2147483648 2147483647 ECU_ADDRESS 0x40001a34 /end MEASUREMENT
/begin MEASUREMENT splsd21Release "����������״̬" SLONG thothfcu100_CM_int32 0 0 -2147483648 2147483647 ECU_ADDRESS 0x40001924 /end MEASUREMENT
/begin MEASUREMENT splsd22Drain "������ˮ��״̬" SLONG thothfcu100_CM_int32 0 0 -2147483648 2147483647 ECU_ADDRESS 0x40001870 /end MEASUREMENT
/begin MEASUREMENT splsd6MainFan "������״̬" SLONG thothfcu100_CM_int32 0 0 -2147483648 2147483647 ECU_ADDRESS 0x400017f8 /end MEASUREMENT
/begin MEASUREMENT splsd7ViceFan "����ɢ�ȷ���״̬" SLONG thothfcu100_CM_int32 0 0 -2147483648 2147483647 ECU_ADDRESS 0x40001944 /end MEASUREMENT
/begin MEASUREMENT splsd8VicePump "����ɢ��ˮ��״̬" SLONG thothfcu100_CM_int32 0 0 -2147483648 2147483647 ECU_ADDRESS 0x400018cc /end MEASUREMENT
/begin MEASUREMENT spXDRP2 "XDRP2" SLONG thothfcu100_CM_int32_mv 0 0 0.0 6000.0 ECU_ADDRESS 0x40001a14 /end MEASUREMENT
/begin MEASUREMENT spXDRP1 "XDRP1" SLONG thothfcu100_CM_int32_mv 0 0 0.0 6000.0 ECU_ADDRESS 0x400018ec /end MEASUREMENT
/begin MEASUREMENT av1RawHPStacIn "AN1" SLONG thothfcu100_CM_int32 0 0 0.0 6000.0 ECU_ADDRESS 0x40001a9c /end MEASUREMENT
/begin MEASUREMENT Battery_Vol "" SLONG thothfcu100_CM_int32 0 0 18000.0 32000.0 ECU_ADDRESS 0x40001a1c /end MEASUREMENT
/begin MEASUREMENT ECU_Temperature "" SLONG thothfcu100_CM_int32 0 0 -40.0 125.0 ECU_ADDRESS 0x40001994 /end MEASUREMENT
/begin MEASUREMENT pbRunState "" SLONG thothfcu100_CM_int32 0 0 -2147483648 2147483647 ECU_ADDRESS 0x4000189c /end MEASUREMENT
/begin MEASUREMENT Lsd "" SLONG thothfcu100_CM_int32 0 0 -2147483648 2147483647 ECU_ADDRESS 0x4000194c /end MEASUREMENT
/begin MEASUREMENT PWM_Out "" SLONG thothfcu100_CM_int32 0 0 -2147483648 2147483647 ECU_ADDRESS 0x40001980 /end MEASUREMENT
/begin MEASUREMENT pbTime "������ԭʼ" ULONG thothfcu100_CM_uint32 0 0 0 4294967295 ECU_ADDRESS 0x40001a2c /end MEASUREMENT
/begin MEASUREMENT AirCompFeedbackSpeed "" ULONG thothfcu100_CM_uint32 0 0 0.0 1.0 ECU_ADDRESS 0x40001960 /end MEASUREMENT
/begin MEASUREMENT pbCheckHign "" ULONG thothfcu100_CM_uint32 0 0 0 4294967295 ECU_ADDRESS 0x4000198c /end MEASUREMENT
/begin MEASUREMENT pbPostLow "" ULONG thothfcu100_CM_uint32 0 0 0 4294967295 ECU_ADDRESS 0x400019f4 /end MEASUREMENT
/begin MEASUREMENT pbHiCode "" ULONG thothfcu100_CM_uint32 0 0 0 4294967295 ECU_ADDRESS 0x40001a60 /end MEASUREMENT
/begin MEASUREMENT AFB_Spd "" SWORD thothfcu100_CM_int16 0 0 0.0 1.0 ECU_ADDRESS 0x40001a6c /end MEASUREMENT
/begin MEASUREMENT Status "" SWORD thothfcu100_CM_int16 0 0 -32768 32767 ECU_ADDRESS 0x40001894 /end MEASUREMENT
/begin MEASUREMENT ThermSInvalidData "" UWORD thothfcu100_CM_uint16 0 0 0.0 1.0 ECU_ADDRESS 0x40001a68 /end MEASUREMENT
/begin MEASUREMENT AirCompBusBarVoltage "" UWORD thothfcu100_CM_uint16 0 0 0.0 1.0 ECU_ADDRESS 0x40001a0c /end MEASUREMENT
/begin MEASUREMENT AirCompModel "" UWORD thothfcu100_CM_uint16 0 0 0.0 1.0 ECU_ADDRESS 0x400018d8 /end MEASUREMENT
/begin MEASUREMENT AirCompMotorPower "" UWORD thothfcu100_CM_uint16 0 0 0.0 1.0 ECU_ADDRESS 0x40001a3c /end MEASUREMENT
/begin MEASUREMENT AirCompSoftVersion "" UWORD thothfcu100_CM_uint16 0 0 0.0 1.0 ECU_ADDRESS 0x4000186c /end MEASUREMENT
/begin MEASUREMENT HPumpSpeedFeedback "" UWORD thothfcu100_CM_uint16 0 0 0.0 1.0 ECU_ADDRESS 0x40001852 /end MEASUREMENT
/begin MEASUREMENT HPumpVoltage "" UWORD thothfcu100_CM_uint16 0 0 0.0 1.0 ECU_ADDRESS 0x4000198a /end MEASUREMENT
/begin MEASUREMENT MainPumpCurrentSpeed "���ת��" UWORD thothfcu100_CM_uint16 0 0 0.0 65535.0 ECU_ADDRESS 0x400019de /end MEASUREMENT
/begin MEASUREMENT DCH_Bat_Vol "" UWORD thothfcu100_CM_uint16 0 0 0.0 1.0 ECU_ADDRESS 0x40001aa6 /end MEASUREMENT
/begin MEASUREMENT DCH_lin "" UWORD thothfcu100_CM_uint16 0 0 0.0 1.0 ECU_ADDRESS 0x40001804 /end MEASUREMENT
/begin MEASUREMENT DCH_Iout "" UWORD thothfcu100_CM_uint16 0 0 0.0 1.0 ECU_ADDRESS 0x400019d8 /end MEASUREMENT
/begin MEASUREMENT DCH_Uin "" UWORD thothfcu100_CM_uint16 0 0 0.0 1.0 ECU_ADDRESS 0x40001854 /end MEASUREMENT
/begin MEASUREMENT DCH_Uout "" UWORD thothfcu100_CM_uint16 0 0 0.0 1.0 ECU_ADDRESS 0x400017ea /end MEASUREMENT
/begin MEASUREMENT DTC "" UWORD thothfcu100_CM_uint16 0 0 0 65535 ECU_ADDRESS 0x400018dc /end MEASUREMENT
/begin MEASUREMENT ThermSLoss "" SBYTE thothfcu100_CM_int8 0 0 0.0 1.0 ECU_ADDRESS 0x40001884 /end MEASUREMENT
/begin MEASUREMENT HV_PTC_MediumTempFb "" SBYTE thothfcu100_CM_int8 0 0 0.0 1.0 ECU_ADDRESS 0x400019a0 /end MEASUREMENT
/begin MEASUREMENT HV_PTC_PCBTempFb "" SBYTE thothfcu100_CM_int8 0 0 0.0 1.0 ECU_ADDRESS 0x40001a66 /end MEASUREMENT
/begin MEASUREMENT HV_PTC_DutyCycleFb "" SBYTE thothfcu100_CM_int8 0 0 0.0 1.0 ECU_ADDRESS 0x40001a51 /end MEASUREMENT
/begin MEASUREMENT ThermSBusOff "" UBYTE thothfcu100_CM_uint8 0 0 0.0 1.0 ECU_ADDRESS 0x4000197d /end MEASUREMENT
/begin MEASUREMENT ThermSNoData "" UBYTE thothfcu100_CM_uint8 0 0 0.0 1.0 ECU_ADDRESS 0x400017f2 /end MEASUREMENT
/begin MEASUREMENT ThermSLife "" UBYTE thothfcu100_CM_uint8 0 0 0.0 1.0 ECU_ADDRESS 0x400018a9 /end MEASUREMENT
/begin MEASUREMENT ThermFCurrSens "" UBYTE thothfcu100_CM_uint8 0 0 0.0 1.0 ECU_ADDRESS 0x4000186f /end MEASUREMENT
/begin MEASUREMENT ThermFTempSens "" UBYTE thothfcu100_CM_uint8 0 0 0.0 1.0 ECU_ADDRESS 0x40001a53 /end MEASUREMENT
/begin MEASUREMENT ThermFVoltage "" UBYTE thothfcu100_CM_uint8 0 0 0.0 1.0 ECU_ADDRESS 0x400018d1 /end MEASUREMENT
/begin MEASUREMENT ThermFVoltSens "" UBYTE thothfcu100_CM_uint8 0 0 0.0 1.0 ECU_ADDRESS 0x4000187c /end MEASUREMENT
/begin MEASUREMENT ThermFBusOff "" UBYTE thothfcu100_CM_uint8 0 0 0.0 1.0 ECU_ADDRESS 0x40001910 /end MEASUREMENT
/begin MEASUREMENT ThermFEEPROM "" UBYTE thothfcu100_CM_uint8 0 0 0.0 1.0 ECU_ADDRESS 0x40001a90 /end MEASUREMENT
/begin MEASUREMENT ThermFInvalidData "" UBYTE thothfcu100_CM_uint8 0 0 0.0 1.0 ECU_ADDRESS 0x40001a8a /end MEASUREMENT
/begin MEASUREMENT ThermFLoss "" UBYTE thothfcu100_CM_uint8 0 0 0.0 1.0 ECU_ADDRESS 0x4000196d /end MEASUREMENT
/begin MEASUREMENT ThermFNoData "" UBYTE thothfcu100_CM_uint8 0 0 0.0 1.0 ECU_ADDRESS 0x400018ad /end MEASUREMENT
/begin MEASUREMENT ThermFOverCurrent "" UBYTE thothfcu100_CM_uint8 0 0 0.0 1.0 ECU_ADDRESS 0x40001888 /end MEASUREMENT
/begin MEASUREMENT ThermFOverTemperature "" UBYTE thothfcu100_CM_uint8 0 0 0.0 1.0 ECU_ADDRESS 0x400019da /end MEASUREMENT
/begin MEASUREMENT ThermFPosiSens "" UBYTE thothfcu100_CM_uint8 0 0 0.0 1.0 ECU_ADDRESS 0x40001a0b /end MEASUREMENT
/begin MEASUREMENT ETV5311LiveCounter "" UBYTE thothfcu100_CM_uint8 0 0 0.0 1.0 ECU_ADDRESS 0x40001848 /end MEASUREMENT
/begin MEASUREMENT ETV511Reserved "" UBYTE thothfcu100_CM_uint8 0 0 0.0 1.0 ECU_ADDRESS 0x40001987 /end MEASUREMENT
/begin MEASUREMENT ETV5311Checksum "" UBYTE thothfcu100_CM_uint8 0 0 0.0 1.0 ECU_ADDRESS 0x40001a0f /end MEASUREMENT
/begin MEASUREMENT ETV4311LiveCounter "" UBYTE thothfcu100_CM_uint8 0 0 0.0 1.0 ECU_ADDRESS 0x40001986 /end MEASUREMENT
/begin MEASUREMENT ETV411Reserved "" UBYTE thothfcu100_CM_uint8 0 0 0.0 1.0 ECU_ADDRESS 0x40001941 /end MEASUREMENT
/begin MEASUREMENT ETV4311Checksum "" UBYTE thothfcu100_CM_uint8 0 0 0.0 1.0 ECU_ADDRESS 0x40001838 /end MEASUREMENT
/begin MEASUREMENT ETV3311LiveCounter "" UBYTE thothfcu100_CM_uint8 0 0 0.0 1.0 ECU_ADDRESS 0x400019d1 /end MEASUREMENT
/begin MEASUREMENT ETV311Reserved "" UBYTE thothfcu100_CM_uint8 0 0 0.0 1.0 ECU_ADDRESS 0x40001900 /end MEASUREMENT
/begin MEASUREMENT ETV3311Checksum "" UBYTE thothfcu100_CM_uint8 0 0 0.0 1.0 ECU_ADDRESS 0x40001a91 /end MEASUREMENT
/begin MEASUREMENT AirCompTemperature "" UBYTE thothfcu100_CM_uint8 0 0 0.0 1.0 ECU_ADDRESS 0x40001a50 /end MEASUREMENT
/begin MEASUREMENT AirCompControllerTemperature "" UBYTE thothfcu100_CM_uint8 0 0 0.0 1.0 ECU_ADDRESS 0x400019dc /end MEASUREMENT
/begin MEASUREMENT AirCompStatus "" UBYTE thothfcu100_CM_uint8 0 0 0.0 1.0 ECU_ADDRESS 0x400019e4 /end MEASUREMENT
/begin MEASUREMENT AirCompFaultClass "" UBYTE thothfcu100_CM_uint8 0 0 0.0 1.0 ECU_ADDRESS 0x40001885 /end MEASUREMENT
/begin MEASUREMENT AirCompLife "" UBYTE thothfcu100_CM_uint8 0 0 0.0 1.0 ECU_ADDRESS 0x400018ae /end MEASUREMENT
/begin MEASUREMENT AirCompMotorVoltage "" UBYTE thothfcu100_CM_uint8 0 0 0.0 1.0 ECU_ADDRESS 0x40001865 /end MEASUREMENT
/begin MEASUREMENT HPumpChecksum_0x0237 "" UBYTE thothfcu100_CM_uint8 0 0 0.0 1.0 ECU_ADDRESS 0x40001a88 /end MEASUREMENT
/begin MEASUREMENT HPumpHW_MAIN "" UBYTE thothfcu100_CM_uint8 0 0 0.0 1.0 ECU_ADDRESS 0x400017ed /end MEASUREMENT
/begin MEASUREMENT HPumpHW_SUB "" UBYTE thothfcu100_CM_uint8 0 0 0.0 1.0 ECU_ADDRESS 0x40001a08 /end MEASUREMENT
/begin MEASUREMENT HPumpRollingCounter237 "" UBYTE thothfcu100_CM_uint8 0 0 0.0 1.0 ECU_ADDRESS 0x400017f0 /end MEASUREMENT
/begin MEASUREMENT HPumpSW_MAIN "" UBYTE thothfcu100_CM_uint8 0 0 0.0 1.0 ECU_ADDRESS 0x4000180d /end MEASUREMENT
/begin MEASUREMENT HPumpSW_SUB "" UBYTE thothfcu100_CM_uint8 0 0 0.0 1.0 ECU_ADDRESS 0x4000195c /end MEASUREMENT
/begin MEASUREMENT HPumpChecksum236 "" UBYTE thothfcu100_CM_uint8 0 0 0.0 1.0 ECU_ADDRESS 0x40001815 /end MEASUREMENT
/begin MEASUREMENT HPumpState "" UBYTE thothfcu100_CM_uint8 0 0 0.0 1.0 ECU_ADDRESS 0x40001a31 /end MEASUREMENT
/begin MEASUREMENT HPumpRollingCount236 "" UBYTE thothfcu100_CM_uint8 0 0 0.0 1.0 ECU_ADDRESS 0x40001a30 /end MEASUREMENT
/begin MEASUREMENT MainPumpOverTempFault "" UBYTE thothfcu100_CM_uint8 0 0 0.0 3.0 ECU_ADDRESS 0x4000196c /end MEASUREMENT
/begin MEASUREMENT MainPumpOverVoltageFault "" UBYTE thothfcu100_CM_uint8 0 0 0.0 3.0 ECU_ADDRESS 0x40001965 /end MEASUREMENT
/begin MEASUREMENT MainPumpUnderVoltageFault "" UBYTE thothfcu100_CM_uint8 0 0 0.0 3.0 ECU_ADDRESS 0x4000188a /end MEASUREMENT
/begin MEASUREMENT MainPumpCommunicationFault "" UBYTE thothfcu100_CM_uint8 0 0 0.0 3.0 ECU_ADDRESS 0x400019b0 /end MEASUREMENT
/begin MEASUREMENT MainPumpDryRunFault "" UBYTE thothfcu100_CM_uint8 0 0 0.0 3.0 ECU_ADDRESS 0x400018d0 /end MEASUREMENT
/begin MEASUREMENT MainPumpFaultLevel "" UBYTE thothfcu100_CM_uint8 0 0 0.0 3.0 ECU_ADDRESS 0x400017fc /end MEASUREMENT
/begin MEASUREMENT MainPumpGridlockFault "" UBYTE thothfcu100_CM_uint8 0 0 0.0 3.0 ECU_ADDRESS 0x40001850 /end MEASUREMENT
/begin MEASUREMENT MainPumpOverCurrentFault "" UBYTE thothfcu100_CM_uint8 0 0 0.0 3.0 ECU_ADDRESS 0x4000188d /end MEASUREMENT
/begin MEASUREMENT HV_PTC_TempSens_Flt "" UBYTE thothfcu100_CM_uint8 0 0 0.0 1.0 ECU_ADDRESS 0x40001a59 /end MEASUREMENT
/begin MEASUREMENT HV_PTC_TempLim "" UBYTE thothfcu100_CM_uint8 0 0 0.0 1.0 ECU_ADDRESS 0x40001a78 /end MEASUREMENT
/begin MEASUREMENT HV_PTC_HV_Voltage_Valid "" UBYTE thothfcu100_CM_uint8 0 0 0.0 1.0 ECU_ADDRESS 0x400018aa /end MEASUREMENT
/begin MEASUREMENT IGBT_Status "" UBYTE thothfcu100_CM_uint8 0 0 0.0 1.0 ECU_ADDRESS 0x400018e8 /end MEASUREMENT
/begin MEASUREMENT HV_PTC_Status "" UBYTE thothfcu100_CM_uint8 0 0 0.0 1.0 ECU_ADDRESS 0x40001a64 /end MEASUREMENT
/begin MEASUREMENT HV_PTC_ExtPwrSup_Flt "" UBYTE thothfcu100_CM_uint8 0 0 0.0 1.0 ECU_ADDRESS 0x40001886 /end MEASUREMENT
/begin MEASUREMENT HV_PTC_Off_ShortCurr "" UBYTE thothfcu100_CM_uint8 0 0 0.0 1.0 ECU_ADDRESS 0x400018f5 /end MEASUREMENT
/begin MEASUREMENT HV_PTC_CurrSens_Flt "" UBYTE thothfcu100_CM_uint8 0 0 0.0 1.0 ECU_ADDRESS 0x40001887 /end MEASUREMENT
/begin MEASUREMENT HV_PTC_CAN_Flt "" UBYTE thothfcu100_CM_uint8 0 0 0.0 1.0 ECU_ADDRESS 0x400018b1 /end MEASUREMENT
/begin MEASUREMENT RsErr_HV_PTC "" UBYTE thothfcu100_CM_uint8 0 0 0.0 1.0 ECU_ADDRESS 0x40001aa9 /end MEASUREMENT
/begin MEASUREMENT HV_PTC_HV_voltageFb "" UBYTE thothfcu100_CM_uint8 0 0 0.0 1.0 ECU_ADDRESS 0x40001984 /end MEASUREMENT
/begin MEASUREMENT DCH_Heatsink_Temp "" UBYTE thothfcu100_CM_uint8 0 0 0.0 1.0 ECU_ADDRESS 0x40001985 /end MEASUREMENT
/begin MEASUREMENT DCH_MOSFET_Temp "" UBYTE thothfcu100_CM_uint8 0 0 0.0 1.0 ECU_ADDRESS 0x40001a20 /end MEASUREMENT
/begin MEASUREMENT DCH_Sts "" UBYTE thothfcu100_CM_uint8 0 0 0.0 1.0 ECU_ADDRESS 0x40001857 /end MEASUREMENT
/begin MEASUREMENT pb301Life "" UBYTE thothfcu100_CM_uint8 0 0 0 255 ECU_ADDRESS 0x40001974 /end MEASUREMENT
/begin MEASUREMENT pb301ETVC "" UBYTE thothfcu100_CM_uint8 0 0 0 255 ECU_ADDRESS 0x400019b2 /end MEASUREMENT
/begin MEASUREMENT pb301ETVP0 "" UBYTE thothfcu100_CM_uint8 0 0 0 255 ECU_ADDRESS 0x4000187a /end MEASUREMENT
/begin MEASUREMENT pb301ETVP1 "" UBYTE thothfcu100_CM_uint8 0 0 0 255 ECU_ADDRESS 0x40001964 /end MEASUREMENT
/begin MEASUREMENT Key_On "" UBYTE thothfcu100_CM_boolean 0 0 0 1 ECU_ADDRESS 0x400018f7 /end MEASUREMENT
/begin MEASUREMENT toThermFault "�������������ݳ�ʱ��־" UBYTE thothfcu100_CM_boolean 0 0 0 1 ECU_ADDRESS 0x400018f8 /end MEASUREMENT
/begin MEASUREMENT toThermStat "������״̬���ݳ�ʱ��־" UBYTE thothfcu100_CM_boolean 0 0 0 1 ECU_ADDRESS 0x400018ac /end MEASUREMENT
/begin MEASUREMENT toADETV311 "�ܷⷧ���ݳ�ʱ��־" UBYTE thothfcu100_CM_boolean 0 0 0 1 ECU_ADDRESS 0x400019dd /end MEASUREMENT
/begin MEASUREMENT toADETV411 "���������ݳ�ʱ��־" UBYTE thothfcu100_CM_boolean 0 0 0 1 ECU_ADDRESS 0x40001a65 /end MEASUREMENT
/begin MEASUREMENT toADETV511 "��ͨ�����ݳ�ʱ��־" UBYTE thothfcu100_CM_boolean 0 0 0 1 ECU_ADDRESS 0x4000180c /end MEASUREMENT
/begin MEASUREMENT ETV511Alarm1 "" UBYTE thothfcu100_CM_boolean 0 0 0.0 1.0 ECU_ADDRESS 0x400018af /end MEASUREMENT
/begin MEASUREMENT ETV511Alarm2 "" UBYTE thothfcu100_CM_boolean 0 0 0.0 1.0 ECU_ADDRESS 0x400018b0 /end MEASUREMENT
/begin MEASUREMENT ETV511Alarm3 "" UBYTE thothfcu100_CM_boolean 0 0 0.0 1.0 ECU_ADDRESS 0x400019d0 /end MEASUREMENT
/begin MEASUREMENT ETV511Alarm4 "" UBYTE thothfcu100_CM_boolean 0 0 0.0 1.0 ECU_ADDRESS 0x4000180e /end MEASUREMENT
/begin MEASUREMENT ETV511Alarm5 "" UBYTE thothfcu100_CM_boolean 0 0 0.0 1.0 ECU_ADDRESS 0x400019f8 /end MEASUREMENT
/begin MEASUREMENT ETV411Alarm1 "" UBYTE thothfcu100_CM_boolean 0 0 0.0 1.0 ECU_ADDRESS 0x40001954 /end MEASUREMENT
/begin MEASUREMENT ETV411Alarm2 "" UBYTE thothfcu100_CM_boolean 0 0 0.0 1.0 ECU_ADDRESS 0x40001a5c /end MEASUREMENT
/begin MEASUREMENT ETV411Alarm3 "" UBYTE thothfcu100_CM_boolean 0 0 0.0 1.0 ECU_ADDRESS 0x40001a5b /end MEASUREMENT
/begin MEASUREMENT ETV411Alarm4 "" UBYTE thothfcu100_CM_boolean 0 0 0.0 1.0 ECU_ADDRESS 0x4000185d /end MEASUREMENT
/begin MEASUREMENT ETV411Alarm5 "" UBYTE thothfcu100_CM_boolean 0 0 0.0 1.0 ECU_ADDRESS 0x4000188b /end MEASUREMENT
/begin MEASUREMENT ETV311Alarm1 "" UBYTE thothfcu100_CM_boolean 0 0 0.0 1.0 ECU_ADDRESS 0x400017f3 /end MEASUREMENT
/begin MEASUREMENT ETV311Alarm2 "" UBYTE thothfcu100_CM_boolean 0 0 0.0 1.0 ECU_ADDRESS 0x400019db /end MEASUREMENT
/begin MEASUREMENT ETV311Alarm3 "" UBYTE thothfcu100_CM_boolean 0 0 0.0 1.0 ECU_ADDRESS 0x40001a09 /end MEASUREMENT
/begin MEASUREMENT ETV311Alarm4 "" UBYTE thothfcu100_CM_boolean 0 0 0.0 1.0 ECU_ADDRESS 0x400018b8 /end MEASUREMENT
/begin MEASUREMENT ETV311Alarm5 "" UBYTE thothfcu100_CM_boolean 0 0 0.0 1.0 ECU_ADDRESS 0x400019f1 /end MEASUREMENT
/begin MEASUREMENT toACCVP "��ѹ����ѹ�������ݳ�ʱ��־" UBYTE thothfcu100_CM_boolean 0 0 0 1 ECU_ADDRESS 0x400017ec /end MEASUREMENT
/begin MEASUREMENT toACStat "��ѹ��״̬���ݳ�ʱ��־" UBYTE thothfcu100_CM_boolean 0 0 0 1 ECU_ADDRESS 0x400017ee /end MEASUREMENT
/begin MEASUREMENT toACDccTemp "��ѹ��ACDC�¶����ݳ�ʱ��־" UBYTE thothfcu100_CM_boolean 0 0 0 1 ECU_ADDRESS 0x4000195f /end MEASUREMENT
/begin MEASUREMENT AirCompBias24VFault "" UBYTE thothfcu100_CM_boolean 0 0 0.0 1.0 ECU_ADDRESS 0x400017f1 /end MEASUREMENT
/begin MEASUREMENT AirCompDCLinkOverVoltage "" UBYTE thothfcu100_CM_boolean 0 0 0.0 1.0 ECU_ADDRESS 0x40001a28 /end MEASUREMENT
/begin MEASUREMENT AirCompDrinverFault "" UBYTE thothfcu100_CM_boolean 0 0 0.0 1.0 ECU_ADDRESS 0x40001998 /end MEASUREMENT
/begin MEASUREMENT AirCompEEPROMErroFault "" UBYTE thothfcu100_CM_boolean 0 0 0.0 1.0 ECU_ADDRESS 0x40001a10 /end MEASUREMENT
/begin MEASUREMENT AirCompHWOverCurrentA "" UBYTE thothfcu100_CM_boolean 0 0 0.0 1.0 ECU_ADDRESS 0x40001920 /end MEASUREMENT
/begin MEASUREMENT AirCompHWOverCurrentB "" UBYTE thothfcu100_CM_boolean 0 0 0.0 1.0 ECU_ADDRESS 0x4000182d /end MEASUREMENT
/begin MEASUREMENT AirCompHWOverCurrentC "" UBYTE thothfcu100_CM_boolean 0 0 0.0 1.0 ECU_ADDRESS 0x40001878 /end MEASUREMENT
/begin MEASUREMENT AirCompHeratBeatFault "" UBYTE thothfcu100_CM_boolean 0 0 0.0 1.0 ECU_ADDRESS 0x40001879 /end MEASUREMENT
/begin MEASUREMENT AirCompHControllerTemp "" UBYTE thothfcu100_CM_boolean 0 0 0.0 1.0 ECU_ADDRESS 0x4000181c /end MEASUREMENT
/begin MEASUREMENT AirCompHMotorSpeed "" UBYTE thothfcu100_CM_boolean 0 0 0.0 1.0 ECU_ADDRESS 0x40001955 /end MEASUREMENT
/begin MEASUREMENT AirCompHMotorTemp "" UBYTE thothfcu100_CM_boolean 0 0 0.0 1.0 ECU_ADDRESS 0x400019f0 /end MEASUREMENT
/begin MEASUREMENT AirCompDCLinkUnderVoltage "" UBYTE thothfcu100_CM_boolean 0 0 0.0 1.0 ECU_ADDRESS 0x40001897 /end MEASUREMENT
/begin MEASUREMENT AirCompHVoltageInterLockFault "" UBYTE thothfcu100_CM_boolean 0 0 0.0 1.0 ECU_ADDRESS 0x40001889 /end MEASUREMENT
/begin MEASUREMENT AirCompHDCLink "" UBYTE thothfcu100_CM_boolean 0 0 0.0 1.0 ECU_ADDRESS 0x400017ef /end MEASUREMENT
/begin MEASUREMENT AirCompInvalidFactoryConfig "" UBYTE thothfcu100_CM_boolean 0 0 0.0 1.0 ECU_ADDRESS 0x400019b8 /end MEASUREMENT
/begin MEASUREMENT AirCompInvalidModel "" UBYTE thothfcu100_CM_boolean 0 0 0.0 1.0 ECU_ADDRESS 0x400018c8 /end MEASUREMENT
/begin MEASUREMENT AirCompLMotorSpeed "" UBYTE thothfcu100_CM_boolean 0 0 0.0 1.0 ECU_ADDRESS 0x4000197e /end MEASUREMENT
/begin MEASUREMENT AirCompLDCLink "" UBYTE thothfcu100_CM_boolean 0 0 0.0 1.0 ECU_ADDRESS 0x40001a52 /end MEASUREMENT
/begin MEASUREMENT AirCompMotorOverSpeed "" UBYTE thothfcu100_CM_boolean 0 0 0.0 1.0 ECU_ADDRESS 0x400018a0 /end MEASUREMENT
/begin MEASUREMENT AirCompMotorOverTemp "" UBYTE thothfcu100_CM_boolean 0 0 0.0 1.0 ECU_ADDRESS 0x400019b1 /end MEASUREMENT
/begin MEASUREMENT AirCompMotorSpeedBelowMin "" UBYTE thothfcu100_CM_boolean 0 0 0.0 1.0 ECU_ADDRESS 0x4000186e /end MEASUREMENT
/begin MEASUREMENT AirCompReserved "" UBYTE thothfcu100_CM_boolean 0 0 0.0 1.0 ECU_ADDRESS 0x400019e5 /end MEASUREMENT
/begin MEASUREMENT AirCompSoftwareSelfCheckFault "" UBYTE thothfcu100_CM_boolean 0 0 0.0 1.0 ECU_ADDRESS 0x40001aa8 /end MEASUREMENT
/begin MEASUREMENT AirCompSpeedCtrlFault "" UBYTE thothfcu100_CM_boolean 0 0 0.0 1.0 ECU_ADDRESS 0x40001896 /end MEASUREMENT
/begin MEASUREMENT AirCompWaterOverTemp "" UBYTE thothfcu100_CM_boolean 0 0 0.0 1.0 ECU_ADDRESS 0x400018f6 /end MEASUREMENT
/begin MEASUREMENT AirCompBias24VOutofTolerance "" UBYTE thothfcu100_CM_boolean 0 0 0.0 1.0 ECU_ADDRESS 0x400018c2 /end MEASUREMENT
/begin MEASUREMENT AirCompBootFault "" UBYTE thothfcu100_CM_boolean 0 0 0.0 1.0 ECU_ADDRESS 0x40001aa4 /end MEASUREMENT
/begin MEASUREMENT AirCompCalError "" UBYTE thothfcu100_CM_boolean 0 0 0.0 1.0 ECU_ADDRESS 0x400018b2 /end MEASUREMENT
/begin MEASUREMENT AirCompControllerOverTemp "" UBYTE thothfcu100_CM_boolean 0 0 0.0 1.0 ECU_ADDRESS 0x40001930 /end MEASUREMENT
/begin MEASUREMENT toFCSHCPStatus1 "����ѭ����״̬1���ݳ�ʱ��־" UBYTE thothfcu100_CM_boolean 0 0 0 1 ECU_ADDRESS 0x400018c0 /end MEASUREMENT
/begin MEASUREMENT toFCSHCPStatus2 "����ѭ����״̬2���ݳ�ʱ��־" UBYTE thothfcu100_CM_boolean 0 0 0 1 ECU_ADDRESS 0x4000188c /end MEASUREMENT
/begin MEASUREMENT HPumpDCLinkUnderVoltageProtection "" UBYTE thothfcu100_CM_boolean 0 0 0.0 1.0 ECU_ADDRESS 0x40001a0a /end MEASUREMENT
/begin MEASUREMENT HPumpDSPCoreTempHighProtection "" UBYTE thothfcu100_CM_boolean 0 0 0.0 1.0 ECU_ADDRESS 0x4000197f /end MEASUREMENT
/begin MEASUREMENT HPumpElectricPowerLimitationOperation "" UBYTE thothfcu100_CM_boolean 0 0 0.0 1.0 ECU_ADDRESS 0x4000187b /end MEASUREMENT
/begin MEASUREMENT HPumpEstimatorFailProtection "" UBYTE thothfcu100_CM_boolean 0 0 0.0 1.0 ECU_ADDRESS 0x40001ab0 /end MEASUREMENT
/begin MEASUREMENT HPumpIGBTOverHeat1Protection "" UBYTE thothfcu100_CM_boolean 0 0 0.0 1.0 ECU_ADDRESS 0x40001a89 /end MEASUREMENT
/begin MEASUREMENT HPumpIGBTTempSensorOpenWarning "" UBYTE thothfcu100_CM_boolean 0 0 0.0 1.0 ECU_ADDRESS 0x40001a71 /end MEASUREMENT
/begin MEASUREMENT HPumpIGBTTempSensorShortWarning "" UBYTE thothfcu100_CM_boolean 0 0 0.0 1.0 ECU_ADDRESS 0x400019c8 /end MEASUREMENT
/begin MEASUREMENT HPumpIcebreakingFailProtection "" UBYTE thothfcu100_CM_boolean 0 0 0.0 1.0 ECU_ADDRESS 0x40001988 /end MEASUREMENT
/begin MEASUREMENT HPumpInverterCurrImbalanceProtection "" UBYTE thothfcu100_CM_boolean 0 0 0.0 1.0 ECU_ADDRESS 0x400018ab /end MEASUREMENT
/begin MEASUREMENT HPumpLockoutProtection "" UBYTE thothfcu100_CM_boolean 0 0 0.0 1.0 ECU_ADDRESS 0x4000195d /end MEASUREMENT
/begin MEASUREMENT HPumpLostPhaseProtection "" UBYTE thothfcu100_CM_boolean 0 0 0.0 1.0 ECU_ADDRESS 0x4000185c /end MEASUREMENT
/begin MEASUREMENT HPumpMicroElecCurrADProtection "" UBYTE thothfcu100_CM_boolean 0 0 0.0 1.0 ECU_ADDRESS 0x4000195e /end MEASUREMENT
/begin MEASUREMENT HPumpMicroElecVDCADProtection "" UBYTE thothfcu100_CM_boolean 0 0 0.0 1.0 ECU_ADDRESS 0x40001a6a /end MEASUREMENT
/begin MEASUREMENT HPumpMotor_HT_Limited_Speed "" UBYTE thothfcu100_CM_boolean 0 0 0.0 1.0 ECU_ADDRESS 0x400018c1 /end MEASUREMENT
/begin MEASUREMENT HPumpMotor_Over_TEMP_Fault "" UBYTE thothfcu100_CM_boolean 0 0 0.0 1.0 ECU_ADDRESS 0x40001856 /end MEASUREMENT
/begin MEASUREMENT HPumpOutputHardwareOverCurrProtection "" UBYTE thothfcu100_CM_boolean 0 0 0.0 1.0 ECU_ADDRESS 0x4000182c /end MEASUREMENT
/begin MEASUREMENT HPumpOutputPeakCurrentProtection "" UBYTE thothfcu100_CM_boolean 0 0 0.0 1.0 ECU_ADDRESS 0x40001a0e /end MEASUREMENT
/begin MEASUREMENT HPumpOutputRMSCurrentProtection "" UBYTE thothfcu100_CM_boolean 0 0 0.0 1.0 ECU_ADDRESS 0x40001a58 /end MEASUREMENT
/begin MEASUREMENT HPumpOverSpeedMAXProtection "" UBYTE thothfcu100_CM_boolean 0 0 0.0 1.0 ECU_ADDRESS 0x400018de /end MEASUREMENT
/begin MEASUREMENT HPumpOverSpeedStartProtection "" UBYTE thothfcu100_CM_boolean 0 0 0.0 1.0 ECU_ADDRESS 0x40001a70 /end MEASUREMENT
/begin MEASUREMENT HPumpCommuChecksumErrorWarning "" UBYTE thothfcu100_CM_boolean 0 0 0.0 1.0 ECU_ADDRESS 0x400017f4 /end MEASUREMENT
/begin MEASUREMENT HPumpCommuRollingCounterWarning "" UBYTE thothfcu100_CM_boolean 0 0 0.0 1.0 ECU_ADDRESS 0x40001909 /end MEASUREMENT
/begin MEASUREMENT HPumpDCLinkOverVoltageProtection "" UBYTE thothfcu100_CM_boolean 0 0 0.0 1.0 ECU_ADDRESS 0x400019d2 /end MEASUREMENT
/begin MEASUREMENT toMainPumpStatus "��ˮ�����ݳ�ʱ��־" UBYTE thothfcu100_CM_boolean 0 0 0 1 ECU_ADDRESS 0x400018f4 /end MEASUREMENT
/begin MEASUREMENT toPTC "PTC���ݳ�ʱ��־" UBYTE thothfcu100_CM_boolean 0 0 0 1 ECU_ADDRESS 0x40001814 /end MEASUREMENT
/begin MEASUREMENT toDCHEleSts "DC���ź����ݳ�ʱ��־" UBYTE thothfcu100_CM_boolean 0 0 0 1 ECU_ADDRESS 0x4000197c /end MEASUREMENT
/begin MEASUREMENT toDCHWorkSts "DC����״̬���ݳ�ʱ��־" UBYTE thothfcu100_CM_boolean 0 0 0 1 ECU_ADDRESS 0x400017e8 /end MEASUREMENT
/begin MEASUREMENT DCInputOverCurrentFault "" UBYTE thothfcu100_CM_boolean 0 0 0.0 1.0 ECU_ADDRESS 0x400018da /end MEASUREMENT
/begin MEASUREMENT DCInputOverVoltageFault "" UBYTE thothfcu100_CM_boolean 0 0 0.0 1.0 ECU_ADDRESS 0x40001a6f /end MEASUREMENT
/begin MEASUREMENT DCInputRelayFailure "" UBYTE thothfcu100_CM_boolean 0 0 0.0 1.0 ECU_ADDRESS 0x4000196e /end MEASUREMENT
/begin MEASUREMENT DCInputUnderVoltageFault "" UBYTE thothfcu100_CM_boolean 0 0 0.0 1.0 ECU_ADDRESS 0x400018a8 /end MEASUREMENT
/begin MEASUREMENT DCMOSFETOverTempFault "" UBYTE thothfcu100_CM_boolean 0 0 0.0 1.0 ECU_ADDRESS 0x4000196f /end MEASUREMENT
/begin MEASUREMENT DCModuleFailure "" UBYTE thothfcu100_CM_boolean 0 0 0.0 1.0 ECU_ADDRESS 0x40001aa5 /end MEASUREMENT
/begin MEASUREMENT DCOutputOverCurrentFault "" UBYTE thothfcu100_CM_boolean 0 0 0.0 1.0 ECU_ADDRESS 0x400019a8 /end MEASUREMENT
/begin MEASUREMENT DCOutputOverVoltageFault "" UBYTE thothfcu100_CM_boolean 0 0 0.0 1.0 ECU_ADDRESS 0x400019e6 /end MEASUREMENT
/begin MEASUREMENT DCOutputUnderVoltageFault "" UBYTE thothfcu100_CM_boolean 0 0 0.0 1.0 ECU_ADDRESS 0x40001a6e /end MEASUREMENT
/begin MEASUREMENT DCShutdownProtectionFault "" UBYTE thothfcu100_CM_boolean 0 0 0.0 1.0 ECU_ADDRESS 0x40001840 /end MEASUREMENT
/begin MEASUREMENT DCCanCommFault "" UBYTE thothfcu100_CM_boolean 0 0 0.0 1.0 ECU_ADDRESS 0x40001940 /end MEASUREMENT
/begin MEASUREMENT DCCoolingPlateOverTempFault "" UBYTE thothfcu100_CM_boolean 0 0 0.0 1.0 ECU_ADDRESS 0x40001864 /end MEASUREMENT
/begin MEASUREMENT DCDCHardwareFault "" UBYTE thothfcu100_CM_boolean 0 0 0.0 1.0 ECU_ADDRESS 0x40001948 /end MEASUREMENT
/begin MEASUREMENT DCInputAndOutputVoltageDontMatch "" UBYTE thothfcu100_CM_boolean 0 0 0.0 1.0 ECU_ADDRESS 0x400019b3 /end MEASUREMENT
/begin MEASUREMENT DCInputCurrLevel3Fault "" UBYTE thothfcu100_CM_boolean 0 0 0.0 1.0 ECU_ADDRESS 0x40001a5a /end MEASUREMENT
/begin MEASUREMENT Lock "" UBYTE thothfcu100_CM_boolean 0 0 0 1 ECU_ADDRESS 0x40001908 /end MEASUREMENT
/begin MEASUREMENT Mprd "" UBYTE thothfcu100_CM_boolean 0 0 0 1 ECU_ADDRESS 0x40001851 /end MEASUREMENT
/begin MEASUREMENT av31WTStacOut "AN31" FLOAT64_IEEE thothfcu100_CM_double_mv 0 0 0.0 6000.0 ECU_ADDRESS 0x400018e0 /end MEASUREMENT
/begin MEASUREMENT av30WTStacIn "AN30" FLOAT64_IEEE thothfcu100_CM_double_mv 0 0 0.0 6000.0 ECU_ADDRESS 0x400019c0 /end MEASUREMENT
/begin MEASUREMENT av8HTStacOut "AN0" FLOAT64_IEEE thothfcu100_CM_double_mv 0 0 0.0 6000.0 ECU_ADDRESS 0x40001a00 /end MEASUREMENT
/begin MEASUREMENT av9HTPumpOut "AN9" FLOAT64_IEEE thothfcu100_CM_double_mv 0 0 0.0 6000.0 ECU_ADDRESS 0x40001a48 /end MEASUREMENT
/begin MEASUREMENT av7HTStacIn "AN7" SLONG thothfcu100_CM_int32_mv 0 0 0.0 6000.0 ECU_ADDRESS 0x40001874 /end MEASUREMENT
/begin MEASUREMENT av18ATStacOut "AN9" FLOAT64_IEEE thothfcu100_CM_double_mv 0 0 0.0 6000.0 ECU_ADDRESS 0x400019e8 /end MEASUREMENT
/begin MEASUREMENT av11ATStacIn "AN9" FLOAT64_IEEE thothfcu100_CM_double_mv 0 0 0.0 6000.0 ECU_ADDRESS 0x40001918 /end MEASUREMENT
/begin MEASUREMENT av10ATCoolOut "AN9" FLOAT64_IEEE thothfcu100_CM_double_mv 0 0 0.0 6000.0 ECU_ADDRESS 0x40001830 /end MEASUREMENT
/begin MEASUREMENT av5WPStatcIn "AN5" SLONG thothfcu100_CM_int32_mV 0 0 0.0 6000.0 ECU_ADDRESS 0x40001a74 /end MEASUREMENT
/begin MEASUREMENT av6WPStacOut "AN6" SLONG thothfcu100_CM_int32_mv 0 0 0.0 6000.0 ECU_ADDRESS 0x40001858 /end MEASUREMENT
/begin MEASUREMENT av2HPStacOut "AN2" SLONG thothfcu100_CM_int32_mV 0 0 0.0 6000.0 ECU_ADDRESS 0x40001824 /end MEASUREMENT
/begin MEASUREMENT av1HPStacIn "AN1" SLONG thothfcu100_CM_int32 0 0 0.0 6000.0 ECU_ADDRESS 0x400019cc /end MEASUREMENT
/begin MEASUREMENT av0HPProp "AN0" SLONG thothfcu100_CM_int32 0 0 0.0 6000.0 ECU_ADDRESS 0x40001938 /end MEASUREMENT
/begin MEASUREMENT av16APStacOut "AN16" SLONG thothfcu100_CM_int32_mV 0 0 0.0 6000.0 ECU_ADDRESS 0x40001a54 /end MEASUREMENT
/begin MEASUREMENT av15APStacIn "AN15" SLONG thothfcu100_CM_int32_mv 0 0 0.0 6000.0 ECU_ADDRESS 0x400018d4 /end MEASUREMENT
/begin MEASUREMENT av14APCoolOut "AN14" SLONG thothfcu100_CM_int32_mv 0 0 0.0 6000.0 ECU_ADDRESS 0x400019e0 /end MEASUREMENT
/begin MEASUREMENT pbe_HIPC "" FLOAT32_IEEE thothfcu100_CM_single 0 0 -3.4E+38 3.4E+38 ECU_ADDRESS 0x40001a38 /end MEASUREMENT
/begin MEASUREMENT pbHIPC "" FLOAT32_IEEE thothfcu100_CM_single 0 0 -3.4E+38 3.4E+38 ECU_ADDRESS 0x4000193c /end MEASUREMENT
/begin MEASUREMENT pbHPropInC "" SLONG thothfcu100_CM_int32 0 0 -2147483648 2147483647 ECU_ADDRESS 0x400018c4 /end MEASUREMENT
/begin MEASUREMENT pbPropC "" SLONG thothfcu100_CM_int32 0 0 -2147483648 2147483647 ECU_ADDRESS 0x40001a98 /end MEASUREMENT
/begin MEASUREMENT pbAdjustPropC "" SLONG thothfcu100_CM_int32 0 0 -2147483648 2147483647 ECU_ADDRESS 0x40001950 /end MEASUREMENT
/begin MEASUREMENT pbe_HIPO "" FLOAT32_IEEE thothfcu100_CM_single 0 0 -3.4E+38 3.4E+38 ECU_ADDRESS 0x40001990 /end MEASUREMENT
/begin MEASUREMENT pbHIPO "" FLOAT32_IEEE thothfcu100_CM_single 0 0 -3.4E+38 3.4E+38 ECU_ADDRESS 0x400019a4 /end MEASUREMENT
/begin MEASUREMENT pbHPropInO "" SLONG thothfcu100_CM_int32 0 0 -2147483648 2147483647 ECU_ADDRESS 0x40001934 /end MEASUREMENT
/begin MEASUREMENT pbPropO "" SLONG thothfcu100_CM_int32 0 0 -2147483648 2147483647 ECU_ADDRESS 0x400018a4 /end MEASUREMENT
/begin MEASUREMENT pbAdjustPropO "" SLONG thothfcu100_CM_int32 0 0 -2147483648 2147483647 ECU_ADDRESS 0x40001818 /end MEASUREMENT
/begin COMPU_METHOD thothfcu100_CM_int32 "Q = V" RAT_FUNC "%10.0" "" COEFFS 0 1 0 0 0 1 /end COMPU_METHOD
/begin COMPU_METHOD thothfcu100_CM_single "Q = V" RAT_FUNC "%8.6" "" COEFFS 0 1 0 0 0 1 /end COMPU_METHOD
/begin COMPU_METHOD thothfcu100_CM_int16 "Q = V" RAT_FUNC "%5.0" "" COEFFS 0 1 0 0 0 1 /end COMPU_METHOD
/begin COMPU_METHOD thothfcu100_CM_uint16 "Q = V" RAT_FUNC "%5.0" "" COEFFS 0 1 0 0 0 1 /end COMPU_METHOD
/begin COMPU_METHOD thothfcu100_CM_int8 "Q = V" RAT_FUNC "%3.0" "" COEFFS 0 1 0 0 0 1 /end COMPU_METHOD
/begin COMPU_METHOD thothfcu100_CM_uint8 "Q = V" RAT_FUNC "%3.0" "" COEFFS 0 1 0 0 0 1 /end COMPU_METHOD
/begin COMPU_METHOD thothfcu100_CM_boolean "Q = V" RAT_FUNC "%1.0" "" COEFFS 0 1 0 0 0 1 /end COMPU_METHOD
/begin COMPU_METHOD thothfcu100_CM_single_mPa "Q = V" RAT_FUNC "%8.6" "mPa" COEFFS 0 1 0 0 0 1 /end COMPU_METHOD
/begin COMPU_METHOD thothfcu100_CM_int32_mv "Q = V" RAT_FUNC "%10.0" "mv" COEFFS 0 1 0 0 0 1 /end COMPU_METHOD
/begin COMPU_METHOD thothfcu100_CM_uint32 "Q = V" RAT_FUNC "%10.0" "" COEFFS 0 1 0 0 0 1 /end COMPU_METHOD
/begin COMPU_METHOD thothfcu100_CM_double_mv "Q = V" RAT_FUNC "%15.10" "mv" COEFFS 0 1 0 0 0 1 /end COMPU_METHOD
/begin COMPU_METHOD thothfcu100_CM_int32_mV "Q = V" RAT_FUNC "%10.0" "mV" COEFFS 0 1 0 0 0 1 /end COMPU_METHOD
/begin GROUP thothfcu100 "thothfcu100" /* Root */ ROOT /begin SUB_GROUP Root_Actor Root_Diagnosis Root_Process Root_Sensor /end SUB_GROUP /end GROUP
/begin GROUP Root_Actor "thothfcu100/Actor" /begin SUB_GROUP S1_CanAD301Tran /end SUB_GROUP /end GROUP
/begin GROUP Root_Diagnosis "thothfcu100/Diagnosis" /begin SUB_GROUP S2_Calibration_Variate S2_Override_Variate /end SUB_GROUP /begin REF_MEASUREMENT DTC /end REF_MEASUREMENT /end GROUP
/begin GROUP Root_Process "thothfcu100/Process"
 /begin SUB_GROUP S3_ACControl S3_AD301 S3_AD401 S3_AD501 S3_DCControl S3_HPumpCtrol S3_LSDControl S3_MainFlow S3_MainPumpControl S3_PTC S3_PowerON S3_ThermControl /end SUB_GROUP
/end GROUP
/begin GROUP Root_Sensor "thothfcu100/Sensor" /begin SUB_GROUP S4_CAN S4_DI S4_LSD S4_Misc S4_sPressure S4_sTemperature /end SUB_GROUP /end GROUP
/begin GROUP S1_CanAD301Tran "thothfcu100/Actor/CanAD301Tran" /begin SUB_GROUP S7_Probe S7_Probe1 S7_Probe2 S7_Probe3 /end SUB_GROUP /end GROUP
/begin GROUP S2_Calibration_Variate "thothfcu100/Diagnosis/Calibration Variate" /begin REF_CHARACTERISTIC Diagnosis_Detect_Enable /end REF_CHARACTERISTIC /end GROUP
/begin GROUP S2_Override_Variate "thothfcu100/Diagnosis/Override Variate" /begin REF_CHARACTERISTIC Diagnosis_Detect_Rst /end REF_CHARACTERISTIC /end GROUP
/begin GROUP S3_ACControl "thothfcu100/Process/ACControl" /begin SUB_GROUP S48_cvACEnable S48_cvACSpeed S48_cvACTran /end SUB_GROUP /end GROUP
/begin GROUP S3_AD301 "thothfcu100/Process/AD301" /begin SUB_GROUP S49_AD301ETVP S49_AD301Tran S49_cvADETVC301 /end SUB_GROUP /end GROUP
/begin GROUP S3_AD401 "thothfcu100/Process/AD401" /begin SUB_GROUP S50_cvAD401Tran S50_cvADETVC401 S50_cvADETVP401 /end SUB_GROUP /end GROUP
/begin GROUP S3_AD501 "thothfcu100/Process/AD501" /begin SUB_GROUP S51_cvAD501Tran S51_cvADETVC501 S51_cvADETVP501 /end SUB_GROUP /end GROUP
/begin GROUP S3_DCControl "thothfcu100/Process/DCControl" /begin SUB_GROUP S52_DCHCtrl S52_DCHHidden S52_DCHIin S52_cvDCTran /end SUB_GROUP /end GROUP
/begin GROUP S3_HPumpCtrol "thothfcu100/Process/HPumpCtrol" /begin SUB_GROUP S53_cvFCSHMode S53_cvFCSHSpeed S53_cvHPTran /end SUB_GROUP /end GROUP
/begin GROUP S3_LSDControl "thothfcu100/Process/LSDControl"
 /begin SUB_GROUP S54_HProport S54_HStopValue S54_MainFan S54_ViceFan S54_VicePump S54_cvDCK3 S54_cvDCK4 S54_cvHDrain S54_cvHRelease /end SUB_GROUP
/end GROUP
/begin GROUP S3_MainFlow "thothfcu100/Process/MainFlow"
 /begin SUB_GROUP S55_Calibration_Variate S55_Calibration_Variate1 S55_HiL S55_LowL S55_MainProcess S55_Probe S55_compens S55_kdHIPC S55_kdHIPO S55_kiHIPC S55_kiHIPO S55_kpHIPC S55_kpHIPO S55_pbPostHigh S55_pbPostLow S55_pbPostLow2 S55_trc S55_tro S55_tro1 S55_tro2 S55_tro3 S55_tro4 S55_tro5 /end SUB_GROUP
/end GROUP
/begin GROUP S3_MainPumpControl "thothfcu100/Process/MainPumpControl" /begin SUB_GROUP S56_MainPumpEn S56_MainPumpSpeed S56_cvMPTran /end SUB_GROUP /end GROUP
/begin GROUP S3_PTC "thothfcu100/Process/PTC"
 /begin SUB_GROUP S57_PTCDisCharge S57_PTCEmgOff S57_PTCHeat S57_PTCOn S57_PTCReset S57_cvPTCTran /end SUB_GROUP
/end GROUP
/begin GROUP S3_PowerON "thothfcu100/Process/PowerON" /begin SUB_GROUP S58_Main_Ms /end SUB_GROUP /begin REF_MEASUREMENT Lock Lsd Mprd Status /end REF_MEASUREMENT /end GROUP
/begin GROUP S3_ThermControl "thothfcu100/Process/ThermControl" /begin SUB_GROUP S59_ThermTran S59_ThermoOperMode S59_ThermoValid /end SUB_GROUP /end GROUP
/begin GROUP S4_CAN "thothfcu100/Sensor/CAN" /begin SUB_GROUP S163_Can0 S163_DCDC S163_PTC S163____ /end SUB_GROUP /end GROUP
/begin GROUP S4_DI "thothfcu100/Sensor/DI" /begin SUB_GROUP S164_Probe /end SUB_GROUP /begin REF_MEASUREMENT spAirFlow /end REF_MEASUREMENT /end GROUP
/begin GROUP S4_LSD "thothfcu100/Sensor/LSD"
 /begin REF_MEASUREMENT splsd0HProport splsd16DC3 splsd17DC4 splsd20HStop splsd21Release splsd22Drain splsd6MainFan splsd7ViceFan splsd8VicePump /end REF_MEASUREMENT
/end GROUP
/begin GROUP S4_Misc "thothfcu100/Sensor/Misc" /begin REF_MEASUREMENT Battery_Vol ECU_Temperature Key_On /end REF_MEASUREMENT /end GROUP
/begin GROUP S4_sPressure "thothfcu100/Sensor/sPressure"
 /begin SUB_GROUP S167_avAPCoolOut S167_avAPStacIn S167_avAPStacOut S167_avHPProp S167_avHPStacIn S167_avHPStacOut S167_avWPStacOut S167_avWPStatcIn S167_v2p S167_v2p1 S167_v2p2 S167_v2p3 S167_v2p4 S167_v2p5 S167_v2p6 S167_v2p7 S167_v2p8 S167_vHPStacIn /end SUB_GROUP
 /begin REF_MEASUREMENT spXDRP1 /end REF_MEASUREMENT
/end GROUP
/begin GROUP S4_sTemperature "thothfcu100/Sensor/sTemperature"
 /begin SUB_GROUP S168_Volt2Temperature S168_Volt2Temperature1 S168_Volt2Temperature2 S168_Volt2Temperature3 S168_Volt2Temperature4 S168_Volt2Temperature5 S168_Volt2Temperature6 S168_Volt2Temperature7 S168_avATCoolOut S168_avATStacIn S168_avATStacOut S168_avHPProp S168_avHTPumpOut S168_avHTStacOut S168_avWTStacIn S168_avWTStacOut /end SUB_GROUP
 /begin REF_MEASUREMENT spXDRP2 /end REF_MEASUREMENT
/end GROUP
/begin GROUP S7_Probe "thothfcu100/Actor/CanAD301Tran/Probe" /begin REF_MEASUREMENT pb301Life /end REF_MEASUREMENT /end GROUP
/begin GROUP S7_Probe1 "thothfcu100/Actor/CanAD301Tran/Probe1" /begin REF_MEASUREMENT pb301ETVC /end REF_MEASUREMENT /end GROUP
/begin GROUP S7_Probe2 "thothfcu100/Actor/CanAD301Tran/Probe2" /begin REF_MEASUREMENT pb301ETVP0 /end REF_MEASUREMENT /end GROUP
/begin GROUP S7_Probe3 "thothfcu100/Actor/CanAD301Tran/Probe3" /begin REF_MEASUREMENT pb301ETVP1 /end REF_MEASUREMENT /end GROUP
/begin GROUP S48_cvACEnable "thothfcu100/Process/ACControl/cvACEnable" /begin REF_CHARACTERISTIC cvACEnable /end REF_CHARACTERISTIC /end GROUP
/begin GROUP S48_cvACSpeed "thothfcu100/Process/ACControl/cvACSpeed" /begin REF_CHARACTERISTIC cvACSpeed /end REF_CHARACTERISTIC /end GROUP
/begin GROUP S48_cvACTran "thothfcu100/Process/ACControl/cvACTran" /begin REF_CHARACTERISTIC cvACTran /end REF_CHARACTERISTIC /end GROUP
/begin GROUP S49_AD301ETVP "thothfcu100/Process/AD301/AD301ETVP" /begin REF_CHARACTERISTIC cvADETVP301 /end REF_CHARACTERISTIC /end GROUP
/begin GROUP S49_AD301Tran "thothfcu100/Process/AD301/AD301Tran" /begin REF_CHARACTERISTIC cvAD301Tran /end REF_CHARACTERISTIC /end GROUP
/begin GROUP S49_cvADETVC301 "thothfcu100/Process/AD301/cvADETVC301" /begin REF_CHARACTERISTIC cvADETVC301 /end REF_CHARACTERISTIC /end GROUP
/begin GROUP S50_cvAD401Tran "thothfcu100/Process/AD401/cvAD401Tran" /begin REF_CHARACTERISTIC cvAD401Tran /end REF_CHARACTERISTIC /end GROUP
/begin GROUP S50_cvADETVC401 "thothfcu100/Process/AD401/cvADETVC401" /begin REF_CHARACTERISTIC cvADETVC401 /end REF_CHARACTERISTIC /end GROUP
/begin GROUP S50_cvADETVP401 "thothfcu100/Process/AD401/cvADETVP401" /begin REF_CHARACTERISTIC cvADETVP401 /end REF_CHARACTERISTIC /end GROUP
/begin GROUP S51_cvAD501Tran "thothfcu100/Process/AD501/cvAD501Tran" /begin REF_CHARACTERISTIC cvAD501Tran /end REF_CHARACTERISTIC /end GROUP
/begin GROUP S51_cvADETVC501 "thothfcu100/Process/AD501/cvADETVC501" /begin REF_CHARACTERISTIC cvADETVC501 /end REF_CHARACTERISTIC /end GROUP
/begin GROUP S51_cvADETVP501 "thothfcu100/Process/AD501/cvADETVP501" /begin REF_CHARACTERISTIC cvADETVP501 /end REF_CHARACTERISTIC /end GROUP
/begin GROUP S52_DCHCtrl "thothfcu100/Process/DCControl/DCHCtrl" /begin REF_CHARACTERISTIC cvDCHCtrl /end REF_CHARACTERISTIC /end GROUP
/begin GROUP S52_DCHHidden "thothfcu100/Process/DCControl/DCHHidden" /begin REF_CHARACTERISTIC cvDCHHidden /end REF_CHARACTERISTIC /end GROUP
/begin GROUP S52_DCHIin "thothfcu100/Process/DCControl/DCHIin" /begin REF_CHARACTERISTIC cvDCHIin /end REF_CHARACTERISTIC /end GROUP
/begin GROUP S52_cvDCTran "thothfcu100/Process/DCControl/cvDCTran" /begin REF_CHARACTERISTIC cvDCTran /end REF_CHARACTERISTIC /end GROUP
/begin GROUP S53_cvFCSHMode "thothfcu100/Process/HPumpCtrol/cvFCSHMode" /begin REF_CHARACTERISTIC cvHPFCSHMode /end REF_CHARACTERISTIC /end GROUP
/begin GROUP S53_cvFCSHSpeed "thothfcu100/Process/HPumpCtrol/cvFCSHSpeed" /begin REF_CHARACTERISTIC cvHPFCSHSpeed /end REF_CHARACTERISTIC /end GROUP
/begin GROUP S53_cvHPTran "thothfcu100/Process/HPumpCtrol/cvHPTran" /begin REF_CHARACTERISTIC cvHPTran /end REF_CHARACTERISTIC /end GROUP
/begin GROUP S54_HProport "thothfcu100/Process/LSDControl/HProport" /begin REF_CHARACTERISTIC cvHProport /end REF_CHARACTERISTIC /end GROUP
/begin GROUP S54_HStopValue "thothfcu100/Process/LSDControl/HStopValue" /begin REF_CHARACTERISTIC cvHStop /end REF_CHARACTERISTIC /end GROUP
/begin GROUP S54_MainFan "thothfcu100/Process/LSDControl/MainFan" /begin REF_CHARACTERISTIC cvMainFan /end REF_CHARACTERISTIC /end GROUP
/begin GROUP S54_ViceFan "thothfcu100/Process/LSDControl/ViceFan" /begin REF_CHARACTERISTIC cvViceFan /end REF_CHARACTERISTIC /end GROUP
/begin GROUP S54_VicePump "thothfcu100/Process/LSDControl/VicePump" /begin REF_CHARACTERISTIC cvVicePump /end REF_CHARACTERISTIC /end GROUP
/begin GROUP S54_cvDCK3 "thothfcu100/Process/LSDControl/cvDCK3" /begin REF_CHARACTERISTIC cvDCK3 /end REF_CHARACTERISTIC /end GROUP
/begin GROUP S54_cvDCK4 "thothfcu100/Process/LSDControl/cvDCK4" /begin REF_CHARACTERISTIC cvDCK4 /end REF_CHARACTERISTIC /end GROUP
/begin GROUP S54_cvHDrain "thothfcu100/Process/LSDControl/cvHDrain" /begin REF_CHARACTERISTIC cvHDrain /end REF_CHARACTERISTIC /end GROUP
/begin GROUP S54_cvHRelease "thothfcu100/Process/LSDControl/cvHRelease" /begin REF_CHARACTERISTIC cvHRelease /end REF_CHARACTERISTIC /end GROUP
/begin GROUP S55_Calibration_Variate "thothfcu100/Process/MainFlow/Calibration Variate" /begin REF_CHARACTERISTIC cvStartUp /end REF_CHARACTERISTIC /end GROUP
/begin GROUP S55_Calibration_Variate1 "thothfcu100/Process/MainFlow/Calibration Variate1" /begin REF_CHARACTERISTIC cvAcTest /end REF_CHARACTERISTIC /end GROUP
/begin GROUP S55_HiL "thothfcu100/Process/MainFlow/HiL" /begin REF_CHARACTERISTIC cov_hi /end REF_CHARACTERISTIC /end GROUP
/begin GROUP S55_LowL "thothfcu100/Process/MainFlow/LowL" /begin REF_CHARACTERISTIC cov_low /end REF_CHARACTERISTIC /end GROUP
/begin GROUP S55_Probe "thothfcu100/Process/MainFlow/Probe" /begin REF_MEASUREMENT pbRunState /end REF_MEASUREMENT /end GROUP
/begin GROUP S55_compens "thothfcu100/Process/MainFlow/compens" /begin REF_CHARACTERISTIC cov_compens /end REF_CHARACTERISTIC /end GROUP
/begin GROUP S55_kdHIPC "thothfcu100/Process/MainFlow/kdHIPC" /begin REF_CHARACTERISTIC cov_kdhipc /end REF_CHARACTERISTIC /end GROUP
/begin GROUP S55_kdHIPO "thothfcu100/Process/MainFlow/kdHIPO" /begin REF_CHARACTERISTIC cov_kdhipo /end REF_CHARACTERISTIC /end GROUP
/begin GROUP S55_kiHIPC "thothfcu100/Process/MainFlow/kiHIPC" /begin REF_CHARACTERISTIC cov_kihipc /end REF_CHARACTERISTIC /end GROUP
/begin GROUP S55_kiHIPO "thothfcu100/Process/MainFlow/kiHIPO" /begin REF_CHARACTERISTIC cov_kihipo /end REF_CHARACTERISTIC /end GROUP
/begin GROUP S55_kpHIPC "thothfcu100/Process/MainFlow/kpHIPC" /begin REF_CHARACTERISTIC cov_kphipc /end REF_CHARACTERISTIC /end GROUP
/begin GROUP S55_kpHIPO "thothfcu100/Process/MainFlow/kpHIPO" /begin REF_CHARACTERISTIC cov_kphipo /end REF_CHARACTERISTIC /end GROUP
/begin GROUP S55_pbPostHigh "thothfcu100/Process/MainFlow/pbPostHigh" /begin REF_MEASUREMENT pbCheckHign /end REF_MEASUREMENT /end GROUP
/begin GROUP S55_pbPostLow "thothfcu100/Process/MainFlow/pbPostLow" /begin REF_MEASUREMENT pbPostLow /end REF_MEASUREMENT /end GROUP
/begin GROUP S55_pbPostLow2 "thothfcu100/Process/MainFlow/pbPostLow2" /begin REF_MEASUREMENT pbHiCode /end REF_MEASUREMENT /end GROUP
/begin GROUP S55_trc "thothfcu100/Process/MainFlow/trc" /begin REF_CHARACTERISTIC cov_releasec /end REF_CHARACTERISTIC /end GROUP
/begin GROUP S55_tro "thothfcu100/Process/MainFlow/tro" /begin REF_CHARACTERISTIC cov_releaseo /end REF_CHARACTERISTIC /end GROUP
/begin GROUP S55_tro1 "thothfcu100/Process/MainFlow/tro1" /begin REF_CHARACTERISTIC cov_precounts /end REF_CHARACTERISTIC /end GROUP
/begin GROUP S55_tro2 "thothfcu100/Process/MainFlow/tro2" /begin REF_CHARACTERISTIC cov_aftercounts /end REF_CHARACTERISTIC /end GROUP
/begin GROUP S55_tro3 "thothfcu100/Process/MainFlow/tro3" /begin REF_CHARACTERISTIC cov_HiAd /end REF_CHARACTERISTIC /end GROUP
/begin GROUP S55_tro4 "thothfcu100/Process/MainFlow/tro4" /begin REF_CHARACTERISTIC cov_LoAd /end REF_CHARACTERISTIC /end GROUP
/begin GROUP S55_tro5 "thothfcu100/Process/MainFlow/tro5" /begin REF_CHARACTERISTIC cov_workCond /end REF_CHARACTERISTIC /end GROUP
/begin GROUP S55_MainProcess "thothfcu100/Process/MainFlow/MainProcess" /begin SUB_GROUP S92_getP401 S92_getProportC S92_getProportO /end SUB_GROUP /end GROUP
/begin GROUP S56_MainPumpEn "thothfcu100/Process/MainPumpControl/MainPumpEn" /begin REF_CHARACTERISTIC cvMPEn /end REF_CHARACTERISTIC /end GROUP
/begin GROUP S56_MainPumpSpeed "thothfcu100/Process/MainPumpControl/MainPumpSpeed" /begin REF_CHARACTERISTIC cvMPSpeed /end REF_CHARACTERISTIC /end GROUP
/begin GROUP S56_cvMPTran "thothfcu100/Process/MainPumpControl/cvMPTran" /begin REF_CHARACTERISTIC cvMPTran /end REF_CHARACTERISTIC /end GROUP
/begin GROUP S57_PTCDisCharge "thothfcu100/Process/PTC/PTCDisCharge" /begin REF_CHARACTERISTIC cvPTCDisCharge /end REF_CHARACTERISTIC /end GROUP
/begin GROUP S57_PTCEmgOff "thothfcu100/Process/PTC/PTCEmgOff" /begin REF_CHARACTERISTIC cvPTCEmgOff /end REF_CHARACTERISTIC /end GROUP
/begin GROUP S57_PTCHeat "thothfcu100/Process/PTC/PTCHeat" /begin REF_CHARACTERISTIC cvPTCHeat /end REF_CHARACTERISTIC /end GROUP
/begin GROUP S57_PTCOn "thothfcu100/Process/PTC/PTCOn" /begin REF_CHARACTERISTIC cvPTCOn /end REF_CHARACTERISTIC /end GROUP
/begin GROUP S57_PTCReset "thothfcu100/Process/PTC/PTCReset" /begin REF_CHARACTERISTIC cvPTCReset /end REF_CHARACTERISTIC /end GROUP
/begin GROUP S57_cvPTCTran "thothfcu100/Process/PTC/cvPTCTran" /begin REF_CHARACTERISTIC cvPTCTran /end REF_CHARACTERISTIC /end GROUP
/begin GROUP S58_Main_Ms "thothfcu100/Process/PowerON/Main_Ms" /begin SUB_GROUP S158_PWM_Cal /end SUB_GROUP /end GROUP
/begin GROUP S59_ThermTran "thothfcu100/Process/ThermControl/ThermTran" /begin REF_CHARACTERISTIC cvThermTran /end REF_CHARACTERISTIC /end GROUP
/begin GROUP S59_ThermoOperMode "thothfcu100/Process/ThermControl/ThermoOperMode" /begin REF_CHARACTERISTIC cvThermOper /end REF_CHARACTERISTIC /end GROUP
/begin GROUP S59_ThermoValid "thothfcu100/Process/ThermControl/ThermoValid" /begin REF_CHARACTERISTIC cvThermValid /end REF_CHARACTERISTIC /end GROUP
/begin GROUP S163_Can0 "thothfcu100/Sensor/CAN/Can0" /begin SUB_GROUP S169_Subsystem /end SUB_GROUP /end GROUP
/begin GROUP S163_DCDC "thothfcu100/Sensor/CAN/DCDC" /begin SUB_GROUP S170_fcsDCHEWorkSts S170_fcsDCHEleSts /end SUB_GROUP /begin REF_MEASUREMENT toDCHEleSts toDCHWorkSts /end REF_MEASUREMENT /end GROUP
/begin GROUP S163_PTC "thothfcu100/Sensor/CAN/PTC" /begin SUB_GROUP S171_fcsPTC /end SUB_GROUP /begin REF_MEASUREMENT toPTC /end REF_MEASUREMENT /end GROUP
/begin GROUP S163____ "thothfcu100/Sensor/CAN/��ˮ��"
 /begin SUB_GROUP S172_fcsMainPumpStatus S173_fcsHCPStatus1 S173_fcsHCPStatus2 S174_fcsACCVP S174_fcsACDccTemp S174_fcsACStat S175_fcsADETV311 S175_fcsADETV411 S175_fcsADETV511 S176_fcsThermFault S176_fcsThermStat /end SUB_GROUP
 /begin REF_MEASUREMENT toACCVP toACDccTemp toACStat toADETV311 toADETV411 toADETV511 toFCSHCPStatus1 toFCSHCPStatus2 toMainPumpStatus toThermFault toThermStat /end REF_MEASUREMENT
/end GROUP
/begin GROUP S164_Probe "thothfcu100/Sensor/DI/Probe" /begin REF_MEASUREMENT pbTime /end REF_MEASUREMENT /end GROUP
/begin GROUP S167_avAPCoolOut "thothfcu100/Sensor/sPressure/avAPCoolOut" /begin REF_MEASUREMENT av14APCoolOut /end REF_MEASUREMENT /end GROUP
/begin GROUP S167_avAPStacIn "thothfcu100/Sensor/sPressure/avAPStacIn" /begin REF_MEASUREMENT av15APStacIn /end REF_MEASUREMENT /end GROUP
/begin GROUP S167_avAPStacOut "thothfcu100/Sensor/sPressure/avAPStacOut" /begin REF_MEASUREMENT av16APStacOut /end REF_MEASUREMENT /end GROUP
/begin GROUP S167_avHPProp "thothfcu100/Sensor/sPressure/avHPProp" /begin REF_MEASUREMENT av0HPProp /end REF_MEASUREMENT /end GROUP
/begin GROUP S167_avHPStacIn "thothfcu100/Sensor/sPressure/avHPStacIn" /begin REF_MEASUREMENT av1HPStacIn /end REF_MEASUREMENT /end GROUP
/begin GROUP S167_avHPStacOut "thothfcu100/Sensor/sPressure/avHPStacOut" /begin REF_MEASUREMENT av2HPStacOut /end REF_MEASUREMENT /end GROUP
/begin GROUP S167_avWPStacOut "thothfcu100/Sensor/sPressure/avWPStacOut" /begin REF_MEASUREMENT av6WPStacOut /end REF_MEASUREMENT /end GROUP
/begin GROUP S167_avWPStatcIn "thothfcu100/Sensor/sPressure/avWPStatcIn" /begin REF_MEASUREMENT av5WPStatcIn /end REF_MEASUREMENT /end GROUP
/begin GROUP S167_v2p "thothfcu100/Sensor/sPressure/v2p" /begin REF_MEASUREMENT sp0HPProp /end REF_MEASUREMENT /end GROUP
/begin GROUP S167_v2p1 "thothfcu100/Sensor/sPressure/v2p1" /begin REF_MEASUREMENT sp1HPStacIn /end REF_MEASUREMENT /end GROUP
/begin GROUP S167_v2p2 "thothfcu100/Sensor/sPressure/v2p2" /begin REF_MEASUREMENT sp2HPStacOut /end REF_MEASUREMENT /end GROUP
/begin GROUP S167_v2p3 "thothfcu100/Sensor/sPressure/v2p3" /begin REF_MEASUREMENT sp5WPStatcIn /end REF_MEASUREMENT /end GROUP
/begin GROUP S167_v2p4 "thothfcu100/Sensor/sPressure/v2p4" /begin REF_MEASUREMENT sp6WPStacOut /end REF_MEASUREMENT /end GROUP
/begin GROUP S167_v2p5 "thothfcu100/Sensor/sPressure/v2p5" /begin REF_MEASUREMENT sp14APCoolOut /end REF_MEASUREMENT /end GROUP
/begin GROUP S167_v2p6 "thothfcu100/Sensor/sPressure/v2p6" /begin REF_MEASUREMENT sp15APStacIn /end REF_MEASUREMENT /end GROUP
/begin GROUP S167_v2p7 "thothfcu100/Sensor/sPressure/v2p7" /begin REF_MEASUREMENT sp16APStacOut /end REF_MEASUREMENT /end GROUP
/begin GROUP S167_v2p8 "thothfcu100/Sensor/sPressure/v2p8" /begin REF_MEASUREMENT sp1RawHPStacIn /end REF_MEASUREMENT /end GROUP
/begin GROUP S167_vHPStacIn "thothfcu100/Sensor/sPressure/vHPStacIn" /begin REF_MEASUREMENT av1RawHPStacIn /end REF_MEASUREMENT /end GROUP
/begin GROUP S168_Volt2Temperature "thothfcu100/Sensor/sTemperature/Volt2Temperature" /begin REF_MEASUREMENT sp7HTStacIn /end REF_MEASUREMENT /end GROUP
/begin GROUP S168_Volt2Temperature1 "thothfcu100/Sensor/sTemperature/Volt2Temperature1" /begin REF_MEASUREMENT sp8HTStacOut /end REF_MEASUREMENT /end GROUP
/begin GROUP S168_Volt2Temperature2 "thothfcu100/Sensor/sTemperature/Volt2Temperature2" /begin REF_MEASUREMENT sp9HTPumpOut /end REF_MEASUREMENT /end GROUP
/begin GROUP S168_Volt2Temperature3 "thothfcu100/Sensor/sTemperature/Volt2Temperature3" /begin REF_MEASUREMENT sp10ATCoolOut /end REF_MEASUREMENT /end GROUP
/begin GROUP S168_Volt2Temperature4 "thothfcu100/Sensor/sTemperature/Volt2Temperature4" /begin REF_MEASUREMENT sp11ATStacIn /end REF_MEASUREMENT /end GROUP
/begin GROUP S168_Volt2Temperature5 "thothfcu100/Sensor/sTemperature/Volt2Temperature5" /begin REF_MEASUREMENT sp18ATStacOut /end REF_MEASUREMENT /end GROUP
/begin GROUP S168_Volt2Temperature6 "thothfcu100/Sensor/sTemperature/Volt2Temperature6" /begin REF_MEASUREMENT sp30WTStacIn /end REF_MEASUREMENT /end GROUP
/begin GROUP S168_Volt2Temperature7 "thothfcu100/Sensor/sTemperature/Volt2Temperature7" /begin REF_MEASUREMENT sp31WTStacOut /end REF_MEASUREMENT /end GROUP
/begin GROUP S168_avATCoolOut "thothfcu100/Sensor/sTemperature/avATCoolOut" /begin REF_MEASUREMENT av10ATCoolOut /end REF_MEASUREMENT /end GROUP
/begin GROUP S168_avATStacIn "thothfcu100/Sensor/sTemperature/avATStacIn" /begin REF_MEASUREMENT av11ATStacIn /end REF_MEASUREMENT /end GROUP
/begin GROUP S168_avATStacOut "thothfcu100/Sensor/sTemperature/avATStacOut" /begin REF_MEASUREMENT av18ATStacOut /end REF_MEASUREMENT /end GROUP
/begin GROUP S168_avHPProp "thothfcu100/Sensor/sTemperature/avHPProp" /begin REF_MEASUREMENT av7HTStacIn /end REF_MEASUREMENT /end GROUP
/begin GROUP S168_avHTPumpOut "thothfcu100/Sensor/sTemperature/avHTPumpOut" /begin REF_MEASUREMENT av9HTPumpOut /end REF_MEASUREMENT /end GROUP
/begin GROUP S168_avHTStacOut "thothfcu100/Sensor/sTemperature/avHTStacOut" /begin REF_MEASUREMENT av8HTStacOut /end REF_MEASUREMENT /end GROUP
/begin GROUP S168_avWTStacIn "thothfcu100/Sensor/sTemperature/avWTStacIn" /begin REF_MEASUREMENT av30WTStacIn /end REF_MEASUREMENT /end GROUP
/begin GROUP S168_avWTStacOut "thothfcu100/Sensor/sTemperature/avWTStacOut" /begin REF_MEASUREMENT av31WTStacOut /end REF_MEASUREMENT /end GROUP
/begin GROUP S92_getP401 "thothfcu100/Process/MainFlow/MainProcess/getP401"
 /begin SUB_GROUP S112_KD S112_KI S112_KP S112_Probe S112_Probe2 S112_Probe3 S112_Probe4 S112_kFlow S112_kPresure S112_kTargetFlow S112_kTargetPresure S112_pbaesum /end SUB_GROUP
/end GROUP
/begin GROUP S92_getProportC "thothfcu100/Process/MainFlow/MainProcess/getProportC"
 /begin SUB_GROUP S113_Probe S113_Probe1 S113_Probe2 S113_Probe3 S113_Probe4 S113_kTargetHIP /end SUB_GROUP
/end GROUP
/begin GROUP S92_getProportO "thothfcu100/Process/MainFlow/MainProcess/getProportO"
 /begin SUB_GROUP S114_Probe S114_Probe1 S114_Probe2 S114_Probe3 S114_Probe4 S114_kTargetHIP /end SUB_GROUP
/end GROUP
/begin GROUP S158_PWM_Cal "thothfcu100/Process/PowerON/Main_Ms/PWM_Cal" /begin REF_CHARACTERISTIC AI_LSD_Table_Data /end REF_CHARACTERISTIC /begin REF_MEASUREMENT PWM_Out /end REF_MEASUREMENT /end GROUP
/begin GROUP S169_Subsystem "thothfcu100/Sensor/CAN/Can0/Subsystem" /begin REF_MEASUREMENT AFB_Spd /end REF_MEASUREMENT /end GROUP
/begin GROUP S170_fcsDCHEWorkSts "thothfcu100/Sensor/CAN/DCDC/fcsDCHEWorkSts"
 /begin REF_MEASUREMENT DCCanCommFault DCCoolingPlateOverTempFault DCDCHardwareFault DCH_Bat_Vol DCH_Heatsink_Temp DCH_MOSFET_Temp DCH_Sts DCInputAndOutputVoltageDontMatch DCInputCurrLevel3Fault DCInputOverCurrentFault DCInputOverVoltageFault DCInputRelayFailure DCInputUnderVoltageFault DCMOSFETOverTempFault DCModuleFailure DCOutputOverCurrentFault DCOutputOverVoltageFault DCOutputUnderVoltageFault DCShutdownProtectionFault /end REF_MEASUREMENT
/end GROUP
/begin GROUP S170_fcsDCHEleSts "thothfcu100/Sensor/CAN/DCDC/fcsDCHEleSts" /begin REF_MEASUREMENT DCH_Iout DCH_Uin DCH_Uout DCH_lin /end REF_MEASUREMENT /end GROUP
/begin GROUP S171_fcsPTC "thothfcu100/Sensor/CAN/PTC/fcsPTC"
 /begin REF_MEASUREMENT HV_PTC_CAN_Flt HV_PTC_CurrSens_Flt HV_PTC_DutyCycleFb HV_PTC_ExtPwrSup_Flt HV_PTC_HV_DC_currFb HV_PTC_HV_Voltage_Valid HV_PTC_HV_voltageFb HV_PTC_MediumTempFb HV_PTC_Off_ShortCurr HV_PTC_PCBTempFb HV_PTC_Status HV_PTC_TempLim HV_PTC_TempSens_Flt IGBT_Status RsErr_HV_PTC /end REF_MEASUREMENT
/end GROUP
/begin GROUP S172_fcsMainPumpStatus "thothfcu100/Sensor/CAN/��ˮ��/fcsMainPumpStatus"
 /begin REF_MEASUREMENT MainPumpCommunicationFault MainPumpCurrentIN MainPumpCurrentSpeed MainPumpDryRunFault MainPumpFaultLevel MainPumpGridlockFault MainPumpHVoltageIN MainPumpInnerTemperature MainPumpOverCurrentFault MainPumpOverTempFault MainPumpOverVoltageFault MainPumpUnderVoltageFault /end REF_MEASUREMENT
/end GROUP
/begin GROUP S173_fcsHCPStatus1 "thothfcu100/Sensor/CAN/������/fcsHCPStatus1"
 /begin REF_MEASUREMENT HPumpChecksum236 HPumpCurrent HPumpRollingCount236 HPumpSpeedFeedback HPumpState HPumpVoltage /end REF_MEASUREMENT
/end GROUP
/begin GROUP S173_fcsHCPStatus2 "thothfcu100/Sensor/CAN/������/fcsHCPStatus2"
 /begin REF_MEASUREMENT HPumpChecksum_0x0237 HPumpCommuChecksumErrorWarning HPumpCommuRollingCounterWarning HPumpDCLinkOverVoltageProtection HPumpDCLinkUnderVoltageProtection HPumpDSPCoreTempHighProtection HPumpElectricPowerLimitationOperation HPumpEstimatorFailProtection HPumpHW_MAIN HPumpHW_SUB HPumpIGBTOverHeat1Protection HPumpIGBTTempSensorOpenWarning HPumpIGBTTempSensorShortWarning HPumpIcebreakingFailProtection HPumpInverterCurrImbalanceProtection HPumpLockoutProtection HPumpLostPhaseProtection HPumpMicroElecCurrADProtection HPumpMicroElecVDCADProtection HPumpMotor_HT_Limited_Speed HPumpMotor_Over_TEMP_Fault HPumpOutputHardwareOverCurrProtection HPumpOutputPeakCurrentProtection HPumpOutputRMSCurrentProtection HPumpOverSpeedMAXProtection HPumpOverSpeedStartProtection HPumpRollingCounter237 HPumpSW_MAIN HPumpSW_SUB /end REF_MEASUREMENT
/end GROUP
/begin GROUP S174_fcsACCVP "thothfcu100/Sensor/CAN/��ѹ��/fcsACCVP"
 /begin REF_MEASUREMENT AirCompModel AirCompMotorCurrent AirCompMotorPower AirCompMotorVoltage AirCompSoftVersion /end REF_MEASUREMENT
/end GROUP
/begin GROUP S174_fcsACDccTemp "thothfcu100/Sensor/CAN/��ѹ��/fcsACDccTemp"
 /begin REF_MEASUREMENT AirCompBusBarCurrent AirCompBusBarVoltage AirCompControllerTemperature AirCompFeedbackSpeed AirCompTemperature /end REF_MEASUREMENT
/end GROUP
/begin GROUP S174_fcsACStat "thothfcu100/Sensor/CAN/��ѹ��/fcsACStat"
 /begin REF_MEASUREMENT AirCompBias24VFault AirCompBias24VOutofTolerance AirCompBootFault AirCompCalError AirCompControllerOverTemp AirCompDCLinkOverVoltage AirCompDCLinkUnderVoltage AirCompDrinverFault AirCompEEPROMErroFault AirCompFaultClass AirCompHControllerTemp AirCompHDCLink AirCompHMotorSpeed AirCompHMotorTemp AirCompHVoltageInterLockFault AirCompHWOverCurrentA AirCompHWOverCurrentB AirCompHWOverCurrentC AirCompHeratBeatFault AirCompInvalidFactoryConfig AirCompInvalidModel AirCompLDCLink AirCompLMotorSpeed AirCompLife AirCompMotorOverSpeed AirCompMotorOverTemp AirCompMotorSpeedBelowMin AirCompReserved AirCompSoftwareSelfCheckFault AirCompSpeedCtrlFault AirCompStatus AirCompWaterOverTemp /end REF_MEASUREMENT
/end GROUP
/begin GROUP S175_fcsADETV311 "thothfcu100/Sensor/CAN/������/fcsADETV311"
 /begin REF_MEASUREMENT ETV311Alarm1 ETV311Alarm2 ETV311Alarm3 ETV311Alarm4 ETV311Alarm5 ETV311CurrentPostion ETV311Reserved ETV311TargetPosition ETV3311Checksum ETV3311LiveCounter /end REF_MEASUREMENT
/end GROUP
/begin GROUP S175_fcsADETV411 "thothfcu100/Sensor/CAN/������/fcsADETV411"
 /begin REF_MEASUREMENT ETV411Alarm1 ETV411Alarm2 ETV411Alarm3 ETV411Alarm4 ETV411Alarm5 ETV411CurrentPostion ETV411Reserved ETV411TargetPosition ETV4311Checksum ETV4311LiveCounter /end REF_MEASUREMENT
/end GROUP
/begin GROUP S175_fcsADETV511 "thothfcu100/Sensor/CAN/������/fcsADETV511"
 /begin REF_MEASUREMENT ETV511Alarm1 ETV511Alarm2 ETV511Alarm3 ETV511Alarm4 ETV511Alarm5 ETV511CurrentPostion ETV511Reserved ETV511TargetPosition ETV5311Checksum ETV5311LiveCounter /end REF_MEASUREMENT
/end GROUP
/begin GROUP S176_fcsThermFault "thothfcu100/Sensor/CAN/������/fcsThermFault"
 /begin REF_MEASUREMENT ThermFBusOff ThermFCurrSens ThermFEEPROM ThermFInvalidData ThermFLoss ThermFNoData ThermFOverCurrent ThermFOverTemperature ThermFPosiSens ThermFTempSens ThermFVoltSens ThermFVoltage /end REF_MEASUREMENT
/end GROUP
/begin GROUP S176_fcsThermStat "thothfcu100/Sensor/CAN/������/fcsThermStat"
 /begin REF_MEASUREMENT ThermSActualPostion ThermSBusOff ThermSInvalidData ThermSLife ThermSLoss ThermSNoData ThermSTargetPostion ThermSTemperature /end REF_MEASUREMENT
/end GROUP
/begin GROUP S112_KD "thothfcu100/Process/MainFlow/MainProcess/getP401/KD" /begin REF_CHARACTERISTIC cov_kdin /end REF_CHARACTERISTIC /end GROUP
/begin GROUP S112_KI "thothfcu100/Process/MainFlow/MainProcess/getP401/KI" /begin REF_CHARACTERISTIC cov_kiin /end REF_CHARACTERISTIC /end GROUP
/begin GROUP S112_KP "thothfcu100/Process/MainFlow/MainProcess/getP401/KP" /begin REF_CHARACTERISTIC cov_kpin /end REF_CHARACTERISTIC /end GROUP
/begin GROUP S112_Probe "thothfcu100/Process/MainFlow/MainProcess/getP401/Probe" /begin REF_MEASUREMENT pbHiL /end REF_MEASUREMENT /end GROUP
/begin GROUP S112_Probe2 "thothfcu100/Process/MainFlow/MainProcess/getP401/Probe2" /begin REF_MEASUREMENT pbPre401 /end REF_MEASUREMENT /end GROUP
/begin GROUP S112_Probe3 "thothfcu100/Process/MainFlow/MainProcess/getP401/Probe3" /begin REF_MEASUREMENT pbAdjust401 /end REF_MEASUREMENT /end GROUP
/begin GROUP S112_Probe4 "thothfcu100/Process/MainFlow/MainProcess/getP401/Probe4" /begin REF_MEASUREMENT pbLowL /end REF_MEASUREMENT /end GROUP
/begin GROUP S112_kFlow "thothfcu100/Process/MainFlow/MainProcess/getP401/kFlow" /begin REF_CHARACTERISTIC cvKeyFlow /end REF_CHARACTERISTIC /end GROUP
/begin GROUP S112_kPresure "thothfcu100/Process/MainFlow/MainProcess/getP401/kPresure" /begin REF_CHARACTERISTIC cvKeyPresure /end REF_CHARACTERISTIC /end GROUP
/begin GROUP S112_kTargetFlow "thothfcu100/Process/MainFlow/MainProcess/getP401/kTargetFlow" /begin REF_CHARACTERISTIC cvTargetFlow /end REF_CHARACTERISTIC /end GROUP
/begin GROUP S112_kTargetPresure "thothfcu100/Process/MainFlow/MainProcess/getP401/kTargetPresure" /begin REF_CHARACTERISTIC cvTargetPresure /end REF_CHARACTERISTIC /end GROUP
/begin GROUP S112_pbaesum "thothfcu100/Process/MainFlow/MainProcess/getP401/pbaesum" /begin REF_MEASUREMENT pbaesum /end REF_MEASUREMENT /end GROUP
/begin GROUP S113_Probe "thothfcu100/Process/MainFlow/MainProcess/getProportC/Probe" /begin REF_MEASUREMENT pbe_HIPC /end REF_MEASUREMENT /end GROUP
/begin GROUP S113_Probe1 "thothfcu100/Process/MainFlow/MainProcess/getProportC/Probe1" /begin REF_MEASUREMENT pbHPropInC /end REF_MEASUREMENT /end GROUP
/begin GROUP S113_Probe2 "thothfcu100/Process/MainFlow/MainProcess/getProportC/Probe2" /begin REF_MEASUREMENT pbPropC /end REF_MEASUREMENT /end GROUP
/begin GROUP S113_Probe3 "thothfcu100/Process/MainFlow/MainProcess/getProportC/Probe3" /begin REF_MEASUREMENT pbAdjustPropC /end REF_MEASUREMENT /end GROUP
/begin GROUP S113_Probe4 "thothfcu100/Process/MainFlow/MainProcess/getProportC/Probe4" /begin REF_MEASUREMENT pbHIPC /end REF_MEASUREMENT /end GROUP
/begin GROUP S113_kTargetHIP "thothfcu100/Process/MainFlow/MainProcess/getProportC/kTargetHIP" /begin REF_CHARACTERISTIC cvTargetHIPresC /end REF_CHARACTERISTIC /end GROUP
/begin GROUP S114_Probe "thothfcu100/Process/MainFlow/MainProcess/getProportO/Probe" /begin REF_MEASUREMENT pbe_HIPO /end REF_MEASUREMENT /end GROUP
/begin GROUP S114_Probe1 "thothfcu100/Process/MainFlow/MainProcess/getProportO/Probe1" /begin REF_MEASUREMENT pbHPropInO /end REF_MEASUREMENT /end GROUP
/begin GROUP S114_Probe2 "thothfcu100/Process/MainFlow/MainProcess/getProportO/Probe2" /begin REF_MEASUREMENT pbPropO /end REF_MEASUREMENT /end GROUP
/begin GROUP S114_Probe3 "thothfcu100/Process/MainFlow/MainProcess/getProportO/Probe3" /begin REF_MEASUREMENT pbAdjustPropO /end REF_MEASUREMENT /end GROUP
/begin GROUP S114_Probe4 "thothfcu100/Process/MainFlow/MainProcess/getProportO/Probe4" /begin REF_MEASUREMENT pbHIPO /end REF_MEASUREMENT /end GROUP
/begin GROUP S114_kTargetHIP "thothfcu100/Process/MainFlow/MainProcess/getProportO/kTargetHIP" /begin REF_CHARACTERISTIC cvTargetHIPres /end REF_CHARACTERISTIC /end GROUP
/end MODULE
/end PROJECT
/* (add any file trailer comments here) */
/* EOF thothfcu100.a2l */
